## components/parent_policy/Kconfig
```kconfig
menu "Sprout feature modules"

config FEATURE_PARENT_POLICY
    bool "Enable parent policy cache"
    default y
    depends on FEATURE_CLOUD_AUTH && FEATURE_CONFIG_STORE && FEATURE_DEVICE_BINDING_CLIENT && FEATURE_DEVICE_IDENTITY && FEATURE_VOLUME_CONTROL
    help
        Fetch the effective guardian policy over an authenticated device
        session, validate its monotonic version, persist the bounded fields,
        and apply the maximum speaker volume.

config PARENT_POLICY_REFRESH_INTERVAL_SECONDS
    int "Parent policy refresh interval in seconds"
    depends on FEATURE_PARENT_POLICY
    range 60 86400
    default 900
    help
        Minimum delay between background policy checks. A cached policy stays
        in force until the platform reports a newer version or deletes it.

endmenu
```

## components/playback_history/Kconfig
```kconfig
menu "Sprout feature modules"

config FEATURE_PLAYBACK_HISTORY
    bool "Enable playback history and resume"
    default y
    help
        Keeps a bounded, newest-first ring of playback records (completed or
        interrupted) persisted across restarts so the device can offer
        "继续播放" and report playback history to the platform.

endmenu
```

## components/playback_history_sync/Kconfig
```kconfig
menu "Sprout feature modules"

config FEATURE_PLAYBACK_HISTORY_SYNC
    bool "Enable playback history reporting"
    default y
    depends on FEATURE_PLAYBACK_HISTORY && FEATURE_DEVICE_BINDING_CLIENT && FEATURE_NETWORK_MANAGER && FEATURE_TIME_SYNC
    help
        Reports locally recorded playback outcomes to the platform so the
        guardian sees what the child played and can resume an interrupted item.

config PLAYBACK_HISTORY_SYNC_INTERVAL_SECONDS
    int "Playback history report interval in seconds"
    depends on FEATURE_PLAYBACK_HISTORY_SYNC
    range 15 86400
    default 120

config PLAYBACK_HISTORY_SYNC_RETRY_INTERVAL_SECONDS
    int "Playback history retry interval while offline"
    depends on FEATURE_PLAYBACK_HISTORY_SYNC
    range 5 300
    default 15

endmenu
```

## components/playback_queue/Kconfig
```kconfig
menu "Sprout feature modules"

config FEATURE_PLAYBACK_QUEUE
    bool "Enable prioritized audio playback queue"
    default y
    depends on FEATURE_AUDIO_PIPELINE
    help
        Queue outbound audio by priority, preempt and resume conversations, and
        keep safety announcements on the speaker. The queue scales each frame
        with volume_control when that module is enabled.

config PLAYBACK_QUEUE_CAPACITY
    int "Pending playback items"
    depends on FEATURE_PLAYBACK_QUEUE
    range 2 16
    default 6
    help
        Six items cover a reply, a prompt, and a reminder without letting a
        stalled network grow the queue without bound.

config PLAYBACK_QUEUE_TASK_STACK_SIZE
    int "Playback worker stack size in bytes"
    depends on FEATURE_PLAYBACK_QUEUE
    range 2048 16384
    default 4096

config PLAYBACK_QUEUE_TASK_PRIORITY
    int "Playback worker task priority"
    depends on FEATURE_PLAYBACK_QUEUE
    range 1 20
    default 6
    help
        The worker sits above the network tasks but below the I2S and watchdog
        paths, so a stalled socket cannot starve audio output.

endmenu
```

## components/playback_request/Kconfig
```kconfig
menu "Sprout feature modules"

config FEATURE_PLAYBACK_REQUEST
    bool "Enable on-demand playback request cache"
    default y
    help
        Caches a bounded list of the guardian's on-demand playback requests so
        the device can drain them in order and report each request's terminal
        outcome, staying consistent with the parent app's playback view
        (/api/v1/playback/requests).

endmenu
```

## components/playback_request_sync/Kconfig
```kconfig
menu "Sprout feature modules"

config FEATURE_PLAYBACK_REQUEST_SYNC
    bool "Enable guardian playback request synchronisation"
    default y
    depends on FEATURE_PLAYBACK_REQUEST && FEATURE_DEVICE_BINDING_CLIENT && FEATURE_NETWORK_MANAGER && FEATURE_TIME_SYNC
    help
        Fetches the guardian's on-demand playback requests and merges them into
        the local cache, so the device drains queued requests in order and
        reports their outcomes back to the parent app.

config PLAYBACK_REQUEST_SYNC_INTERVAL_SECONDS
    int "Playback request sync interval in seconds"
    depends on FEATURE_PLAYBACK_REQUEST_SYNC
    range 15 86400
    default 60

config PLAYBACK_REQUEST_SYNC_RETRY_INTERVAL_SECONDS
    int "Playback request sync retry interval while offline"
    depends on FEATURE_PLAYBACK_REQUEST_SYNC
    range 5 300
    default 15

endmenu
```

## components/power_policy_sync/Kconfig
```kconfig
menu "Sprout feature modules"

config FEATURE_POWER_POLICY_SYNC
    bool "Enable power policy synchronisation"
    default y
    depends on FEATURE_BATTERY_POWER && FEATURE_DEVICE_BINDING_CLIENT && FEATURE_NETWORK_MANAGER && FEATURE_TIME_SYNC
    help
        Fetches the family power policy and applies it, keeping a device's
        low-power, deep-sleep and charge-priority policy consistent with the
        parent app.

config POWER_POLICY_SYNC_INTERVAL_SECONDS
    int "Power policy sync interval in seconds"
    depends on FEATURE_POWER_POLICY_SYNC
    range 60 86400
    default 1800

config POWER_POLICY_SYNC_RETRY_INTERVAL_SECONDS
    int "Power policy sync retry interval while offline"
    depends on FEATURE_POWER_POLICY_SYNC
    range 5 300
    default 15

endmenu
```

## components/power_report/Kconfig
```kconfig
menu "Sprout feature modules"

config FEATURE_POWER_REPORT
    bool "Report the live battery status to the platform"
    default n
    depends on FEATURE_BATTERY_POWER && FEATURE_DEVICE_BINDING_CLIENT && FEATURE_NETWORK_MANAGER && FEATURE_TIME_SYNC
    help
        Reports the device's bounded battery charge state, percentage, voltage
        and current power mode so the guardian power overview matches the
        hardware actually present. A device without a battery gauge never links
        the component.

config POWER_REPORT_INTERVAL_SECONDS
    int "Power report interval in seconds"
    depends on FEATURE_POWER_REPORT
    range 300 86400
    default 900

config POWER_REPORT_RETRY_INTERVAL_SECONDS
    int "Power report retry interval while offline"
    depends on FEATURE_POWER_REPORT
    range 5 300
    default 15

endmenu
```

## components/privacy_guard/Kconfig
```kconfig
menu "Sprout feature modules"

config FEATURE_PRIVACY_GUARD
    bool "Enable child privacy guard"
    default y
    depends on FEATURE_CONFIG_STORE
    help
        Tracks guardian consent for audio upload, image upload, conversation
        history, and usage analytics. Every class starts denied and a missing
        or corrupt record is treated as denied.

config PRIVACY_GUARD_AUDIO_UPLOAD_DEFAULT
    bool "Allow audio upload before guardian consent"
    depends on FEATURE_PRIVACY_GUARD
    default n
    help
        Must remain disabled in production. This option exists only for
        controlled development fixtures and is never enabled by default.

config PRIVACY_GUARD_IMAGE_UPLOAD_DEFAULT
    bool "Allow image upload before guardian consent"
    depends on FEATURE_PRIVACY_GUARD
    default n
    help
        Must remain disabled in production.

endmenu
```

## components/prompt_tone/Kconfig
```kconfig
menu "Sprout feature modules"

config FEATURE_PROMPT_TONE
    bool "Enable local system prompt tones"
    default y
    depends on FEATURE_AUDIO_CODEC
    help
        Generate wake, capture, error, network, battery, and safety cues
        locally. Cues go through the playback queue when it is enabled, so
        safety announcements keep their priority and cannot be silenced.

endmenu
```

## components/provisioning_payload/Kconfig
```kconfig
menu "Sprout feature modules"

config FEATURE_PROVISIONING_PAYLOAD
    bool "Enable provisioning payload"
    default y
    help
        Build the sprout://device QR payload a guardian scans to bind this
        device. The payload carries only the single-use binding token, device
        identifier, and display name.

endmenu
```

## components/provisioning_reporter/Kconfig
```kconfig
menu "Sprout feature modules"

config FEATURE_PROVISIONING_REPORTER
    bool "Enable provisioning and connectivity event reporting"
    default y
    depends on FEATURE_CONFIG_STORE && FEATURE_VERSION_INFO
    help
        Records bounded provisioning, binding, network, time, and
        authentication transitions in NVS. The runtime reporter includes
        pending events in its authenticated heartbeat and acknowledges them
        only after the platform accepts the report.

endmenu
```

## components/screen_policy_sync/Kconfig
```kconfig
menu "Sprout feature modules"

config FEATURE_SCREEN_POLICY_SYNC
    bool "Enable screen policy synchronisation"
    default y
    depends on FEATURE_SCREEN_SURFACE && FEATURE_DEVICE_BINDING_CLIENT && FEATURE_NETWORK_MANAGER && FEATURE_TIME_SYNC
    help
        Fetches the family screen policy and applies it, keeping a device's
        default expression, animation, point-to-read and video profile
        consistent with the parent app.

config SCREEN_POLICY_SYNC_INTERVAL_SECONDS
    int "Screen policy sync interval in seconds"
    depends on FEATURE_SCREEN_POLICY_SYNC
    range 60 86400
    default 1800

config SCREEN_POLICY_SYNC_RETRY_INTERVAL_SECONDS
    int "Screen policy sync retry interval while offline"
    depends on FEATURE_SCREEN_POLICY_SYNC
    range 5 300
    default 15

endmenu
```

## components/screen_report/Kconfig
```kconfig
menu "Sprout feature modules"

config FEATURE_SCREEN_REPORT
    bool "Report the live screen state to the platform"
    default n
    depends on FEATURE_SCREEN_SURFACE && FEATURE_DEVICE_BINDING_CLIENT && FEATURE_NETWORK_MANAGER && FEATURE_TIME_SYNC
    help
        Reports the device's screen capability flags and the active expression,
        animation and video state so the guardian screen view matches the
        surface actually rendering. A device without a screen never links the
        component.

config SCREEN_REPORT_INTERVAL_SECONDS
    int "Screen report interval in seconds"
    depends on FEATURE_SCREEN_REPORT
    range 300 86400
    default 900

config SCREEN_REPORT_RETRY_INTERVAL_SECONDS
    int "Screen report retry interval while offline"
    depends on FEATURE_SCREEN_REPORT
    range 5 300
    default 15

endmenu
```

## components/screen_surface/Kconfig
```kconfig
menu "Sprout feature modules"

config FEATURE_SCREEN_SURFACE
    bool "Enable screen expressions, animations, point-to-read and video"
    default n
    help
        Runs the bounded screen-surface policy and helpers: facial expressions,
        built-in animation clips, a point-to-read dictionary and clamped video
        playback plans. A device without a display simply does not link the
        component.

endmenu
```

## components/security_posture/Kconfig
```kconfig
menu "Sprout feature modules"

config FEATURE_SECURITY_POSTURE
    bool "Enable production security posture enforcement"
    default y
    help
        Refuses to run a production image unless Secure Boot and Flash
        Encryption are active, so unsigned firmware and readable keys never
        reach application logic.

config SPROUT_PRODUCTION_BUILD
    bool "Refuse to run without Secure Boot and Flash Encryption"
    depends on FEATURE_SECURITY_POSTURE
    default n
    help
        Enable only for images that ship with Secure Boot and Flash
        Encryption provisioned. When enabled, the firmware halts before any
        module starts if either control is missing. Leave disabled for
        development and factory-provisioning images.

endmenu
```

## components/system_core/Kconfig
```kconfig
menu "Sprout feature modules"

config FEATURE_SYSTEM_CORE
    bool "Enable system core"
    default y
    help
        Initialize shared process primitives and expose the default event loop
        used by removable feature modules.

endmenu
```

## components/temperature_monitor/Kconfig
```kconfig
menu "Sprout feature modules"

config FEATURE_TEMPERATURE_MONITOR
    bool "Enable device temperature monitoring"
    default y
    help
        Reads the on-die temperature sensor and reports a normalized thermal
        band with the runtime heartbeat so operators can alert on heat and the
        device can protect itself.

config TEMPERATURE_MIN_CELSIUS
    int "Minimum measurable temperature in Celsius"
    depends on FEATURE_TEMPERATURE_MONITOR
    range -40 - 0
    default -10

config TEMPERATURE_MAX_CELSIUS
    int "Maximum measurable temperature in Celsius"
    depends on FEATURE_TEMPERATURE_MONITOR
    range 50 - 125
    default 80

config TEMPERATURE_WARM_CELSIUS
    int "Warm band lower bound in Celsius"
    depends on FEATURE_TEMPERATURE_MONITOR
    range 30 - 70
    default 45

config TEMPERATURE_HOT_CELSIUS
    int "Hot band lower bound in Celsius"
    depends on FEATURE_TEMPERATURE_MONITOR
    range 40 - 90
    default 60

config TEMPERATURE_CRITICAL_CELSIUS
    int "Critical band lower bound in Celsius"
    depends on FEATURE_TEMPERATURE_MONITOR
    range 50 - 110
    default 75

endmenu
```

## components/theme_package/Kconfig
```kconfig
menu "Sprout feature modules"

config FEATURE_THEME_PACKAGE
    bool "Enable theme pack cache"
    default y
    help
        Caches a bounded list of published theme packs (ordered collections of
        content package ids) persisted across restarts so the device can offer
        a thematic quick-play menu that matches the parent app.

endmenu
```

## components/theme_package_sync/Kconfig
```kconfig
menu "Sprout feature modules"

config FEATURE_THEME_PACKAGE_SYNC
    bool "Enable theme pack synchronisation"
    default y
    depends on FEATURE_THEME_PACKAGE && FEATURE_DEVICE_BINDING_CLIENT && FEATURE_NETWORK_MANAGER && FEATURE_TIME_SYNC
    help
        Fetches the published theme packs and replaces the local theme cache,
        keeping the device's thematic quick-play menu consistent with the
        parent app.

config THEME_PACKAGE_SYNC_INTERVAL_SECONDS
    int "Theme pack sync interval in seconds"
    depends on FEATURE_THEME_PACKAGE_SYNC
    range 60 86400
    default 1800

config THEME_PACKAGE_SYNC_RETRY_INTERVAL_SECONDS
    int "Theme pack sync retry interval while offline"
    depends on FEATURE_THEME_PACKAGE_SYNC
    range 5 300
    default 15

endmenu
```

## components/time_sync/Kconfig
```kconfig
menu "Sprout feature modules"

config FEATURE_TIME_SYNC
    bool "Enable network time synchronization"
    default y
    depends on FEATURE_CONFIG_STORE && FEATURE_NETWORK_MANAGER
    help
        Synchronizes the device clock through SNTP, persists the last trusted
        time, and reports synchronization failures to cloud_auth and the
        runtime status reporter.

config TIME_SYNC_SNTP_SERVER
    string "SNTP server"
    depends on FEATURE_TIME_SYNC
    default "ntp.aliyun.com"
    help
        Primary SNTP server used before the device connects to the platform.

config TIME_SYNC_RETRY_INTERVAL_SECONDS
    int "Time synchronization retry interval in seconds"
    depends on FEATURE_TIME_SYNC
    range 10 3600
    default 60

config TIME_SYNC_TIMEZONE_OFFSET_MINUTES
    int "Device timezone offset in minutes from UTC"
    depends on FEATURE_TIME_SYNC
    range -840 840
    default 480
    help
        Fixed offset applied to UTC for parent-control disabled periods and
        usage day boundaries. The default +480 matches Asia/Shanghai.

endmenu
```
