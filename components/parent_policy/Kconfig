## components/touch_input/Kconfig
```kconfig
menu "Sprout feature modules"

config FEATURE_TOUCH_INPUT
    bool "Enable touch input and gestures"
    default n
    help
        Applies the guardian's touch configuration (enable, tap, swipe,
        long-press, haptic feedback, sensitivity and rotation) and classifies
        taps, swipes and long presses from bounded samples. The module only
        touches input state, so a device without a touch panel never links it.

endmenu
```

## components/touch_input_sync/Kconfig
```kconfig
menu "Sprout feature modules"

config FEATURE_TOUCH_INPUT_SYNC
    bool "Enable touch input synchronisation"
    default y
    depends on FEATURE_TOUCH_INPUT && FEATURE_DEVICE_BINDING_CLIENT && FEATURE_NETWORK_MANAGER && FEATURE_TIME_SYNC
    help
        Fetches the family touch configuration and applies it, keeping a
        device's tap, swipe, haptic and sensitivity settings consistent with
        the parent app.

config TOUCH_INPUT_SYNC_INTERVAL_SECONDS
    int "Touch input sync interval in seconds"
    depends on FEATURE_TOUCH_INPUT_SYNC
    range 60 86400
    default 1800

config TOUCH_INPUT_SYNC_RETRY_INTERVAL_SECONDS
    int "Touch input sync retry interval while offline"
    depends on FEATURE_TOUCH_INPUT_SYNC
    range 5 300
    default 15

endmenu
```

## components/touch_report/Kconfig
```kconfig
menu "Sprout feature modules"

config FEATURE_TOUCH_REPORT
    bool "Report the live touch configuration to the platform"
    default n
    depends on FEATURE_TOUCH_INPUT && FEATURE_DEVICE_BINDING_CLIENT && FEATURE_NETWORK_MANAGER && FEATURE_TIME_SYNC
    help
        Reports the device's touch and haptic capability and the number of
        enabled gesture classes so the guardian touch view matches the input
        layer actually running. A device without a touch surface never links
        the component.

config TOUCH_REPORT_INTERVAL_SECONDS
    int "Touch report interval in seconds"
    depends on FEATURE_TOUCH_REPORT
    range 300 86400
    default 900

config TOUCH_REPORT_RETRY_INTERVAL_SECONDS
    int "Touch report retry interval while offline"
    depends on FEATURE_TOUCH_REPORT
    range 5 300
    default 15

endmenu
```

## components/transport_security/Kconfig
```kconfig
menu "Sprout feature modules"

config FEATURE_TRANSPORT_SECURITY
    bool "Enable shared transport security policy"
    default y
    help
        Centralizes HTTPS, WSS, and MQTTS validation. Certificate and hostname
        verification are always enabled, and cleartext or downgraded endpoints
        are rejected before any client opens a connection.

config TRANSPORT_SECURITY_ALLOWED_HOST
    string "Optional additional host suffix"
    depends on FEATURE_TRANSPORT_SECURITY
    default ""
    help
        Optional comma-separated host suffixes in addition to clarkhub.cn.
        Leave empty in production unless a second trusted domain is required.

endmenu
```
