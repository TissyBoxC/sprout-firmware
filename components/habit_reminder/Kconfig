## components/habit_reminder/Kconfig
```kconfig
menu "Sprout feature modules"

config FEATURE_HABIT_REMINDER
    bool "Enable habit reminder cache"
    default y
    help
        Caches a bounded set of family habit reminders (local time of day,
        weekday set, enable flag and an optional prompt) persisted across
        restarts so the device can nudge a child offline and stay consistent
        with the parent app's companionship reminders.

endmenu
```

## components/image_privacy/Kconfig
```kconfig
menu "Sprout feature modules"

config FEATURE_IMAGE_PRIVACY
    bool "Enable local image processing and upload authorisation"
    default n
    help
        Runs the bounded image-privacy policy and processing pipeline gate:
        opt-in local processing, guardian-gated upload, a processing mode, an
        upload scope, a retention window, a redaction level and a consent gate.
        A firmware profile without a camera simply does not link the component.

endmenu
```

## components/image_privacy_sync/Kconfig
```kconfig
menu "Sprout feature modules"

config FEATURE_IMAGE_PRIVACY_SYNC
    bool "Enable image-privacy policy synchronisation"
    default y
    depends on FEATURE_IMAGE_PRIVACY && FEATURE_DEVICE_BINDING_CLIENT && FEATURE_NETWORK_MANAGER && FEATURE_TIME_SYNC
    help
        Fetches the family image-privacy policy and applies it, keeping a
        device's processing mode, upload scope, retention window, redaction
        level and consent gate consistent with the parent app.

config IMAGE_PRIVACY_SYNC_INTERVAL_SECONDS
    int "Image-privacy policy sync interval in seconds"
    depends on FEATURE_IMAGE_PRIVACY_SYNC
    range 60 86400
    default 3600

config IMAGE_PRIVACY_SYNC_RETRY_INTERVAL_SECONDS
    int "Image-privacy policy sync retry interval while offline"
    depends on FEATURE_IMAGE_PRIVACY_SYNC
    range 5 300
    default 15

endmenu
```

## components/learning_visualization/Kconfig
```kconfig
menu "Sprout feature modules"

config FEATURE_LEARNING_VISUALIZATION
    bool "Enable touch learning visualization policy"
    default n
    help
        Runs the bounded learning-visualization policy and surface state
        machine: opt-in feedback style, animation level, touch/reward/lesson
        linkage toggles and a session ceiling. A firmware profile without a
        touch display simply does not link the component.

endmenu
```

## components/learning_visualization_sync/Kconfig
```kconfig
menu "Sprout feature modules"

config FEATURE_LEARNING_VISUALIZATION_SYNC
    bool "Enable learning-visualization policy synchronisation"
    default y
    depends on FEATURE_LEARNING_VISUALIZATION && FEATURE_DEVICE_BINDING_CLIENT && FEATURE_NETWORK_MANAGER && FEATURE_TIME_SYNC
    help
        Fetches the family learning-visualization policy and applies it,
        keeping a device's feedback style, animation level, toggles and session
        ceiling consistent with the parent app.

config LEARNING_VISUALIZATION_SYNC_INTERVAL_SECONDS
    int "Learning-visualization policy sync interval in seconds"
    depends on FEATURE_LEARNING_VISUALIZATION_SYNC
    range 60 86400
    default 3600

config LEARNING_VISUALIZATION_SYNC_RETRY_INTERVAL_SECONDS
    int "Learning-visualization policy sync retry interval while offline"
    depends on FEATURE_LEARNING_VISUALIZATION_SYNC
    range 5 300
    default 15

endmenu
```

## components/led_indicator/Kconfig
```kconfig
menu "Sprout feature modules"

config FEATURE_LED_INDICATOR
    bool "Enable status LED indicator"
    default y
    help
        Drive one status LED from LEDC PWM and map device states to bounded
        blink, solid, and breathing patterns. The module keeps the output off
        when the GPIO or LEDC peripheral is unavailable.

config LED_INDICATOR_GPIO
    int "Status LED GPIO number"
    depends on FEATURE_LED_INDICATOR
    range 0 48
    default 38
    help
        Board-profile default is GPIO 38. Change it to the output pin used by
        the product carrier board; the module reports a failure instead of
        driving an invalid pin.

config LED_INDICATOR_ACTIVE_LOW
    bool "Status LED is active low"
    depends on FEATURE_LED_INDICATOR
    default n
    help
        Disabled by default because the current repository has no board
        definition proving an active-low LED. Enable it when the board grounds
        the LED cathode through the GPIO.

config LED_INDICATOR_PWM_FREQUENCY_HZ
    int "LED PWM frequency in Hz"
    depends on FEATURE_LED_INDICATOR
    range 100 5000
    default 1000
    help
        PWM frequencies above the visible flicker range keep brightness
        changes visually smooth.

config LED_INDICATOR_BRIGHTNESS_PERCENT
    int "LED brightness percent"
    depends on FEATURE_LED_INDICATOR
    range 1 100
    default 50
    help
        Relative duty applied to solid, blink, and breathing patterns.

config LED_INDICATOR_TASK_STACK_SIZE
    int "Indicator task stack size in bytes"
    depends on FEATURE_LED_INDICATOR
    range 2048 8192
    default 3072

config LED_INDICATOR_TASK_PRIORITY
    int "Indicator task priority"
    depends on FEATURE_LED_INDICATOR
    range 1 12
    default 2
    help
        The indicator only updates PWM and must remain below audio, network,
        and watchdog work.

config LED_INDICATOR_POLL_INTERVAL_MS
    int "Pattern transition poll interval in milliseconds"
    depends on FEATURE_LED_INDICATOR
    range 5 1000
    default 20
    help
        Bounds how long the task waits before applying a new state. The task
        blocks on a semaphore or this timeout and never busy-spins.

endmenu
```

## components/local_command/Kconfig
```kconfig
menu "Sprout feature modules"

config FEATURE_LOCAL_COMMAND
    bool "Enable offline local command macros"
    default y
    depends on FEATURE_CONFIG_STORE
    help
        Caches a bounded set of guardian-published trigger phrases that map to
        local device actions, so common commands keep working with no network.
        The device resolves phrases locally and never queues audio or child
        data.

endmenu
```

## components/local_command_sync/Kconfig
```kconfig
menu "Sprout feature modules"

config FEATURE_LOCAL_COMMAND_SYNC
    bool "Enable local command synchronisation"
    default y
    depends on FEATURE_LOCAL_COMMAND && FEATURE_DEVICE_BINDING_CLIENT && FEATURE_NETWORK_MANAGER && FEATURE_TIME_SYNC
    help
        Fetches the family's guardian-published local command set and replaces
        the local cache, keeping the offline trigger phrases consistent with the
        parent app.

config LOCAL_COMMAND_SYNC_INTERVAL_SECONDS
    int "Local command sync interval in seconds"
    depends on FEATURE_LOCAL_COMMAND_SYNC
    range 60 86400
    default 900

config LOCAL_COMMAND_SYNC_RETRY_INTERVAL_SECONDS
    int "Local command sync retry interval while offline"
    depends on FEATURE_LOCAL_COMMAND_SYNC
    range 5 300
    default 15

endmenu
```

## components/long_term_memory/Kconfig
```kconfig
menu "Sprout feature modules"

config FEATURE_LONG_TERM_MEMORY
    bool "Enable guardian-authorized long-term memory"
    default y
    help
        Stores a bounded set of guardian-authorized facts about a child
        (preferences, routines, milestones the companion should recall) with a
        minimal, deletion-capable, consent-gated store. Revoking authorization
        erases every remembered fact.

endmenu
```

## components/long_term_memory_sync/Kconfig
```kconfig
menu "Sprout feature modules"

# Secure by default: the sync component stays off in every profile until the
# cloud memory contract ships and the guardian consents to cloud storage.
config LONG_TERM_MEMORY_SYNC_ENABLED
    bool "Enable long-term memory cloud sync"
    default n
    depends on FEATURE_LONG_TERM_MEMORY && FEATURE_DEVICE_BINDING_CLIENT && FEATURE_NETWORK_MANAGER && FEATURE_TIME_SYNC
    help
        Pulls the guardian-authorized long-term memories from the platform and
        merges them into the local store, and uploads memories the device
        learned locally. Local long-term memory keeps working on its own when
        this is disabled.

config LONG_TERM_MEMORY_SYNC_INTERVAL_SECONDS
    int "Long-term memory sync interval in seconds"
    depends on LONG_TERM_MEMORY_SYNC_ENABLED
    range 60 86400
    default 900

config LONG_TERM_MEMORY_SYNC_RETRY_INTERVAL_SECONDS
    int "Long-term memory sync retry interval while offline"
    depends on LONG_TERM_MEMORY_SYNC_ENABLED
    range 5 300
    default 15

endmenu
```

## components/module_registry/Kconfig
```kconfig
menu "Sprout feature modules"

config FEATURE_MODULE_REGISTRY
    bool "Enable module registry"
    default y
    help
        Register removable feature modules and track initialization results
        without requiring the composition root to know each implementation.

config MODULE_REGISTRY_CAPACITY
    int "Maximum registered feature modules"
    depends on FEATURE_MODULE_REGISTRY
    range 1 128
    default 64
    help
        Static registry capacity. Keep this above the number of modules enabled
        by any released product profile.

endmenu
```

## components/motion_control/Kconfig
```kconfig
menu "Sprout feature modules"

config FEATURE_MOTION_CONTROL
    bool "Enable motor, servo and action control"
    default n
    help
        Drives bounded motor and servo channels, plays walk, dance, tail and
        gesture actions, and enforces the guardian's speed, runtime and
        locomotion envelope. Every accepted command is clamped and an action
        stops on timeout, explicit stop or a lost link, so a device without a
        moving body never links the component.

endmenu
```

## components/motion_policy_sync/Kconfig
```kconfig
menu "Sprout feature modules"

config FEATURE_MOTION_POLICY_SYNC
    bool "Enable motion policy synchronisation"
    default y
    depends on FEATURE_MOTION_CONTROL && FEATURE_DEVICE_BINDING_CLIENT && FEATURE_NETWORK_MANAGER && FEATURE_TIME_SYNC
    help
        Fetches the family motion policy and applies it, keeping a device's
        speed, runtime, stop-grace and locomotion policy consistent with the
        parent app.

config MOTION_POLICY_SYNC_INTERVAL_SECONDS
    int "Motion policy sync interval in seconds"
    depends on FEATURE_MOTION_POLICY_SYNC
    range 60 86400
    default 1800

config MOTION_POLICY_SYNC_RETRY_INTERVAL_SECONDS
    int "Motion policy sync retry interval while offline"
    depends on FEATURE_MOTION_POLICY_SYNC
    range 5 300
    default 15

endmenu
```

## components/motion_report/Kconfig
```kconfig
menu "Sprout feature modules"

config FEATURE_MOTION_REPORT
    bool "Report the live motion state to the platform"
    default n
    depends on FEATURE_MOTION_CONTROL && FEATURE_DEVICE_BINDING_CLIENT && FEATURE_NETWORK_MANAGER && FEATURE_TIME_SYNC
    help
        Reports the device's motion lifecycle state, running action, actuator
        count and fault flag so the guardian motion view matches the body
        actually moving. A device without a moving body never links the
        component.

config MOTION_REPORT_INTERVAL_SECONDS
    int "Motion report interval in seconds"
    depends on FEATURE_MOTION_REPORT
    range 300 86400
    default 900

config MOTION_REPORT_RETRY_INTERVAL_SECONDS
    int "Motion report retry interval while offline"
    depends on FEATURE_MOTION_REPORT
    range 5 300
    default 15

endmenu
```

## components/network_manager/Kconfig
```kconfig
menu "Sprout feature modules"

config FEATURE_NETWORK_MANAGER
    bool "Enable network manager"
    default y
    depends on FEATURE_CONFIG_STORE
    help
        Owns the Wi-Fi station lifecycle, connection retries, and the SSID
        visible to other modules. The device stays offline until credentials
        are supplied by provisioning.

endmenu
```

## components/network_quality/Kconfig
```kconfig
menu "Sprout feature modules"

config FEATURE_NETWORK_QUALITY
    bool "Enable network quality measurement"
    default y
    depends on FEATURE_NETWORK_MANAGER
    help
        Measures Wi-Fi RSSI, connection latency, and packet-loss estimate for
        the runtime status contract and the diagnostics module.

config NETWORK_QUALITY_POOR_RSSI
    int "Poor-quality RSSI threshold in dBm"
    depends on FEATURE_NETWORK_QUALITY
    range -127 -60
    default -80

config NETWORK_QUALITY_GOOD_RSSI
    int "Good-quality RSSI threshold in dBm"
    depends on FEATURE_NETWORK_QUALITY
    range -90 -40
    default -65

config NETWORK_QUALITY_EXCELLENT_RSSI
    int "Excellent-quality RSSI threshold in dBm"
    depends on FEATURE_NETWORK_QUALITY
    range -80 -30
    default -50

endmenu
```

## components/offline_content/Kconfig
```kconfig
menu "Sprout feature modules"

config FEATURE_OFFLINE_CONTENT
    bool "Enable offline content playback index"
    default y
    depends on FEATURE_CONFIG_STORE
    help
        Keeps a bounded index of the content packages pinned for offline
        playback, marks a package playable only after the library verified its
        bytes locally, and picks the next playable package. It stores metadata
        only: never content bytes, audio, images, credentials, or child data.

endmenu
```

## components/offline_fallback/Kconfig
```kconfig
menu "Sprout feature modules"

config FEATURE_OFFLINE_FALLBACK
    bool "Enable offline fallback state"
    default y
    depends on FEATURE_CONFIG_STORE && FEATURE_NETWORK_MANAGER
    help
        Tracks network loss, enters a bounded safe mode, queues telemetry
        markers, and exposes a recovery state to the runtime reporter.

config OFFLINE_FALLBACK_GRACE_SECONDS
    int "Seconds to wait before entering offline mode"
    depends on FEATURE_OFFLINE_FALLBACK
    range 0 3600
    default 15

endmenu
```

## components/offline_policy/Kconfig
```kconfig
menu "Sprout feature modules"

config FEATURE_OFFLINE_POLICY
    bool "Enable fleet offline download policy"
    default y
    depends on FEATURE_CONFIG_STORE
    help
        Applies the platform-wide offline download policy: whether offline
        playback is allowed, how many packages and how many bytes the device
        may cache, how long a cached package stays valid, and whether large
        downloads stay on Wi-Fi. The policy is published once for the whole
        fleet, so every bound device shares one cache budget.

endmenu
```

## components/offline_policy_sync/Kconfig
```kconfig
menu "Sprout feature modules"

config FEATURE_OFFLINE_POLICY_SYNC
    bool "Enable fleet offline download policy synchronisation"
    default y
    depends on FEATURE_OFFLINE_POLICY && FEATURE_DEVICE_BINDING_CLIENT && FEATURE_NETWORK_MANAGER && FEATURE_TIME_SYNC
    help
        Fetches the platform-wide offline download policy and applies it, then
        reports the applied revision back so the console can see which devices
        are current. Keeps every device's cache budget consistent with the
        operator's published policy.

config OFFLINE_POLICY_SYNC_INTERVAL_SECONDS
    int "Offline policy sync interval in seconds"
    depends on FEATURE_OFFLINE_POLICY_SYNC
    range 60 86400
    default 1800

config OFFLINE_POLICY_SYNC_RETRY_INTERVAL_SECONDS
    int "Offline policy sync retry interval while offline"
    depends on FEATURE_OFFLINE_POLICY_SYNC
    range 5 300
    default 15

endmenu
```
