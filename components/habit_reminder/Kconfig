## components/ota_download/Kconfig
```kconfig
menu "Sprout feature modules"

config FEATURE_OTA_DOWNLOAD
    bool "Enable secure OTA image download"
    default y
    depends on FEATURE_OTA_VALIDATE
    help
        Streams firmware images over verified HTTPS into the inactive OTA
        partition with SHA-256, size limits, retries, and cancellation.

config OTA_DOWNLOAD_CHUNK_BYTES
    int "OTA download read chunk bytes"
    depends on FEATURE_OTA_DOWNLOAD
    range 1024 16384
    default 4096

config OTA_DOWNLOAD_TIMEOUT_SECONDS
    int "OTA download timeout in seconds"
    depends on FEATURE_OTA_DOWNLOAD
    range 10 600
    default 60

config OTA_DOWNLOAD_MAX_RETRIES
    int "OTA download maximum attempts"
    depends on FEATURE_OTA_DOWNLOAD
    range 1 10
    default 3

endmenu
```

## components/ota_manager/Kconfig
```kconfig
menu "Sprout feature modules"

config FEATURE_OTA_MANAGER
    bool "Enable OTA update manager"
    default y
    depends on FEATURE_OTA_DOWNLOAD && FEATURE_OTA_VALIDATE && FEATURE_OTA_ROLLBACK && FEATURE_CLOUD_AUTH && FEATURE_NETWORK_MANAGER && FEATURE_TIME_SYNC && FEATURE_DEVICE_BINDING_CLIENT && FEATURE_CONFIG_STORE
    help
        Coordinates secure firmware downloads, validation, boot partition
        selection, runtime reporting, and rollback validation.

config OTA_MANAGER_CHANNEL
    string "Firmware release channel"
    depends on FEATURE_OTA_MANAGER
    default "stable"
    help
        Only manifests for this channel are accepted. Supported values are
        stable, canary, and internal.

config OTA_MANAGER_HARDWARE_REVISION
    string "Expected hardware revision"
    depends on FEATURE_OTA_MANAGER
    default "esp32s3"
    help
        Manifest hardware revision accepted by this firmware image.

config OTA_MANAGER_POLL_INTERVAL_SECONDS
    int "OTA poll interval in seconds"
    depends on FEATURE_OTA_MANAGER
    range 60 86400
    default 900

config OTA_MANAGER_TASK_STACK_SIZE
    int "OTA worker task stack size"
    depends on FEATURE_OTA_MANAGER
    default 8192

config OTA_MANAGER_TASK_PRIORITY
    int "OTA worker task priority"
    depends on FEATURE_OTA_MANAGER
    default 3

endmenu
```

## components/ota_rollback/Kconfig
```kconfig
menu "Sprout feature modules"

config FEATURE_OTA_ROLLBACK
    bool "Enable OTA boot rollback protection"
    default y
    depends on FEATURE_OTA_VALIDATE && FEATURE_CONFIG_STORE
    help
        Tracks pending image validation, enforces a boot-attempt budget, and
        rolls back to the previous known-good slot when validation fails.

config OTA_ROLLBACK_MAX_BOOT_ATTEMPTS
    int "Maximum pending image boot attempts"
    depends on FEATURE_OTA_ROLLBACK
    range 1 10
    default 3

endmenu
```

## components/ota_validate/Kconfig
```kconfig
menu "Sprout feature modules"

config FEATURE_OTA_VALIDATE
    bool "Enable OTA manifest and image validation"
    default y
    help
        Parses immutable firmware manifests and validates hardware, channel,
        source version, hashes, signatures, and ESP-IDF image metadata.

config OTA_VALIDATE_TRUSTED_KEYS_JSON
    string "Trusted OTA Ed25519 public keyring"
    depends on FEATURE_OTA_VALIDATE
    default ""
    help
        JSON object mapping signature key IDs to standard Base64 encoded
        32-byte Ed25519 public keys. Empty disables OTA installation because
        no manifest can be authenticated.

endmenu
```

## components/parent_control_runtime/Kconfig
```kconfig
menu "Sprout feature modules"

config FEATURE_PARENT_CONTROL_RUNTIME
    bool "Enable unified parent-control enforcement"
    default y
    depends on FEATURE_PARENT_POLICY && FEATURE_USAGE_LEDGER && FEATURE_TIME_SYNC
    help
        Evaluates guardian disabled periods, category allowlists, and daily
        usage limits through one decision path used by wake detection, voice
        sessions, content download, content playback, and the playback queue.

endmenu
```
