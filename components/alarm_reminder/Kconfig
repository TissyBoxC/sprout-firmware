## components/alarm_reminder/Kconfig
```kconfig
menu "Sprout feature modules"

config FEATURE_ALARM_REMINDER
    bool "Enable alarm reminder cache and local firing state"
    default y
    help
        Caches a bounded set of family alarms (local time of day, weekday set,
        enable flag, snooze window, label and optional prompt), persists them
        across restarts, and tracks the local firing state so the device rings
        at most once per day and reports ringing/snoozed/dismissed/missed back
        to the parent app's alarm reminders.

endmenu
```

## components/alarm_reminder_sync/Kconfig
```kconfig
menu "Sprout feature modules"

config FEATURE_ALARM_REMINDER_SYNC
    bool "Enable alarm reminder schedule synchronisation"
    default y
    depends on FEATURE_ALARM_REMINDER && FEATURE_DEVICE_BINDING_CLIENT && FEATURE_NETWORK_MANAGER && FEATURE_TIME_SYNC
    help
        Fetches the family's enabled alarm schedule and replaces the local
        alarm cache, so a device rings the guardian's reminders even after a
        reboot with no network.

config ALARM_REMINDER_SYNC_INTERVAL_SECONDS
    int "Alarm schedule sync interval in seconds"
    depends on FEATURE_ALARM_REMINDER_SYNC
    range 60 86400
    default 900

config ALARM_REMINDER_SYNC_RETRY_INTERVAL_SECONDS
    int "Alarm schedule sync retry interval while offline"
    depends on FEATURE_ALARM_REMINDER_SYNC
    range 5 300
    default 15

endmenu
```

## components/assessment_sync/Kconfig
```kconfig
menu "Sprout feature modules"

# Secure by default: the device cannot grade a child, so this component only
# mirrors an assessment the guardian drives from the phone. It stays off in
# every profile until the guardian flow that supplies the score ships.
config FEATURE_ASSESSMENT_SYNC
    bool "Enable learning assessment session sync"
    default n
    depends on FEATURE_DEVICE_BINDING_CLIENT && FEATURE_NETWORK_MANAGER && FEATURE_TIME_SYNC
    help
        Fetches the assessment session the guardian started and reports the
        answers the guardian graded on their phone. The firmware has no speech
        recognition, so it never derives a score: it presents the item, keeps
        the answer queued until the platform accepts it, and exposes the run's
        progress. With this disabled, no assessment request is made.

config ASSESSMENT_SYNC_POLL_INTERVAL_SECONDS
    int "Assessment session poll interval in seconds"
    depends on FEATURE_ASSESSMENT_SYNC
    range 15 600
    default 60
    help
        How often an active assessment is re-read. A session lasts at most ten
        minutes, so a minute keeps the device close to the guardian's phone
        without polling the platform per item.

config ASSESSMENT_SYNC_RETRY_INTERVAL_SECONDS
    int "Assessment sync retry interval in seconds"
    depends on FEATURE_ASSESSMENT_SYNC
    range 5 120
    default 15

config ASSESSMENT_SYNC_MAX_RETRY_INTERVAL_SECONDS
    int "Assessment sync maximum backoff in seconds"
    depends on FEATURE_ASSESSMENT_SYNC
    range 30 1800
    default 300
    help
        Consecutive failures double the retry delay up to this cap, so a
        platform outage produces a few attempts instead of a request storm.

config ASSESSMENT_SYNC_TASK_STACK_SIZE
    int "Assessment sync worker stack size"
    depends on FEATURE_ASSESSMENT_SYNC
    range 3072 16384
    default 6144
    help
        The worker parses one session response at a time; the JSON document and
        the item buffers live on this stack.

endmenu
```

## components/audio_codec/Kconfig
```kconfig
menu "Sprout feature modules"

config FEATURE_AUDIO_CODEC
    bool "Enable realtime audio codec"
    default y
    help
        Encode captured microphone PCM into Opus packets and decode inbound
        Opus packets into PCM for the speaker. The gateway and the firmware
        share one fixed profile: 16 kHz, mono, 20 ms Opus frames.

config AUDIO_CODEC_BITRATE
    int "Encoder target bitrate in bits per second"
    depends on FEATURE_AUDIO_CODEC
    range 6000 64000
    default 24000

config AUDIO_CODEC_COMPLEXITY
    int "Opus encoder complexity"
    depends on FEATURE_AUDIO_CODEC
    range 0 10
    default 3
    help
        Lower complexity reduces CPU and current draw on the S3 while keeping
        wideband speech intelligible.

config AUDIO_CODEC_ENABLE_DTX
    bool "Enable discontinuous transmission"
    depends on FEATURE_AUDIO_CODEC
    default n
    help
        DTX suppresses silent frames. Keep it off for the first hardware
        profile so the sequence timeline stays dense and easy to diagnose.

endmenu
```

## components/audio_input/Kconfig
```kconfig
menu "Sprout feature modules"

config FEATURE_AUDIO_INPUT
    bool "Enable microphone capture, preprocessing, VAD, and Opus framing"
    default y
    depends on FEATURE_AUDIO_CODEC && FEATURE_AUDIO_PIPELINE
    help
        Own the conversation capture path: read 20 ms PCM frames, cancel
        speaker echo, suppress steady noise, normalize gain, detect speech, and
        emit Opus packets. The microphone is enabled only while a conversation
        is active, so a device never records in the background.

config AUDIO_INPUT_TASK_STACK_SIZE
    int "Capture task stack size in bytes"
    depends on FEATURE_AUDIO_INPUT
    range 4096 32768
    default 8192

config AUDIO_INPUT_TASK_PRIORITY
    int "Capture task priority"
    depends on FEATURE_AUDIO_INPUT
    range 1 24
    default 7

config AUDIO_INPUT_REFERENCE_QUEUE_FRAMES
    int "Buffered speaker reference frames"
    depends on FEATURE_AUDIO_INPUT
    range 4 32
    default 12
    help
        Bounds how much speaker audio is queued for echo cancellation. The
        queue never grows without limit, so a stalled capture task cannot
        exhaust memory.

config AUDIO_INPUT_AEC_REFERENCE_DELAY_FRAMES
    int "Speaker reference delay in frames"
    depends on FEATURE_AUDIO_INPUT
    range 0 8
    default 2
    help
        Compensates the acoustic round trip between the speaker and the
        microphone. Two frames is 40 ms, which covers the reference hardware's
        codec and DMA latency.

config AUDIO_INPUT_AEC_FILTER_TAPS
    int "Acoustic echo canceller length in samples"
    depends on FEATURE_AUDIO_INPUT
    range 320 2048
    default 512
    help
        The canceller adapts over one whole frame, so the filter must hold at
        least 320 samples. 512 taps model 32 ms of echo path at 16 kHz.

config AUDIO_INPUT_AEC_STEP_PERMILLE
    int "Acoustic echo canceller step size (permille)"
    depends on FEATURE_AUDIO_INPUT
    range 10 1000
    default 300

config AUDIO_INPUT_AEC_LEAKAGE_PERMILLE
    int "Acoustic echo canceller leakage (permille)"
    depends on FEATURE_AUDIO_INPUT
    range 0 100
    default 2

config AUDIO_INPUT_AEC_DOUBLE_TALK_FACTOR_MILLI
    int "Double-talk detection margin (milli)"
    depends on FEATURE_AUDIO_INPUT
    range 1000 8000
    default 1500
    help
        The near-end sample must exceed the recent reference peak by this
        factor before adaptation freezes. 1500 is a 1.5x margin.

config AUDIO_INPUT_NS_NOISE_DOWNWARD_PERMILLE
    int "Noise floor downward tracking (permille)"
    depends on FEATURE_AUDIO_INPUT
    range 1 500
    default 100
    help
        Smaller values let the noise estimate follow a quieter room faster.

config AUDIO_INPUT_NS_NOISE_UPWARD_PERMILLE
    int "Noise floor upward tracking (permille)"
    depends on FEATURE_AUDIO_INPUT
    range 500 999
    default 980
    help
        Larger values stop speech from being absorbed into the noise estimate.

config AUDIO_INPUT_NS_GAIN_SMOOTHING_PERMILLE
    int "Noise suppression gain smoothing (permille)"
    depends on FEATURE_AUDIO_INPUT
    range 1 999
    default 700

config AUDIO_INPUT_NS_FLOOR_GAIN_PERCENT
    int "Noise suppression retained gain (percent)"
    depends on FEATURE_AUDIO_INPUT
    range 0 100
    default 12

config AUDIO_INPUT_AGC_TARGET_RMS
    int "Gain calibration target RMS"
    depends on FEATURE_AUDIO_INPUT
    range 200 8000
    default 1200

config AUDIO_INPUT_AGC_MIN_GAIN_PERCENT
    int "Gain calibration minimum gain (percent)"
    depends on FEATURE_AUDIO_INPUT
    range 10 100
    default 25

config AUDIO_INPUT_AGC_MAX_GAIN_PERCENT
    int "Gain calibration maximum gain (percent)"
    depends on FEATURE_AUDIO_INPUT
    range 100 1600
    default 600

config AUDIO_INPUT_AGC_ATTACK_PERMILLE
    int "Gain calibration attack (permille)"
    depends on FEATURE_AUDIO_INPUT
    range 50 999
    default 700

config AUDIO_INPUT_AGC_RELEASE_PERMILLE
    int "Gain calibration release (permille)"
    depends on FEATURE_AUDIO_INPUT
    range 1 500
    default 50

config AUDIO_INPUT_VAD_SNR_THRESHOLD_MILLI
    int "Voice activity SNR threshold (milli)"
    depends on FEATURE_AUDIO_INPUT
    range 1000 20000
    default 3500

config AUDIO_INPUT_VAD_MIN_SPEECH_FRAMES
    int "Minimum consecutive speech frames"
    depends on FEATURE_AUDIO_INPUT
    range 1 20
    default 2

config AUDIO_INPUT_VAD_HANGOVER_FRAMES
    int "Speech hangover frames"
    depends on FEATURE_AUDIO_INPUT
    range 0 50
    default 12

config AUDIO_INPUT_VAD_NOISE_DOWNWARD_PERMILLE
    int "Voice activity noise floor downward tracking (permille)"
    depends on FEATURE_AUDIO_INPUT
    range 1 500
    default 150

config AUDIO_INPUT_VAD_NOISE_UPWARD_PERMILLE
    int "Voice activity noise floor upward tracking (permille)"
    depends on FEATURE_AUDIO_INPUT
    range 500 999
    default 980

endmenu
```

## components/audio_output/Kconfig
```kconfig
menu "Sprout feature modules"

config FEATURE_AUDIO_OUTPUT
    bool "Enable speaker mixing and volume-managed audio output"
    default y
    depends on FEATURE_AUDIO_PIPELINE
    help
        Own the final speaker output path: mix concurrent PCM sources, apply
        the effective volume, protect safety announcements from mute, and feed
        the mixed frame to the I2S pipeline. The module keeps the playback
        queue separate so scheduling policy and audio rendering stay
        independently testable.

config AUDIO_OUTPUT_QUEUE_FRAMES
    int "Queued frames per output priority"
    depends on FEATURE_AUDIO_OUTPUT
    range 2 32
    default 8
    help
        Bounds each priority lane to eight 20 ms frames (160 ms). This absorbs
        network jitter without adding noticeable conversation latency.

config AUDIO_OUTPUT_TASK_STACK_SIZE
    int "Mix task stack size in bytes"
    depends on FEATURE_AUDIO_OUTPUT
    range 4096 16384
    default 6144

config AUDIO_OUTPUT_TASK_PRIORITY
    int "Mix task priority"
    depends on FEATURE_AUDIO_OUTPUT
    range 1 24
    default 8
    help
        The mix task must keep the I2S write cadence ahead of network tasks
        while leaving the high-priority watchdog and DMA paths above it.

config AUDIO_OUTPUT_FALLBACK_VOLUME_PERCENT
    int "Fallback volume percent without volume_control"
    depends on FEATURE_AUDIO_OUTPUT
    range 0 100
    default 70
    help
        Used only when the removable volume_control module is absent. The
        guardian maximum should remain the normal policy source.

config AUDIO_OUTPUT_SAFETY_MIN_PERCENT
    int "Minimum safety announcement volume percent"
    depends on FEATURE_AUDIO_OUTPUT
    range 1 100
    default 60
    help
        Safety announcements bypass mute and are raised to at least this
        percentage. If the guardian maximum is higher, that maximum is used.

config AUDIO_OUTPUT_SUBMIT_TIMEOUT_MS
    int "Submit retry timeout in milliseconds"
    depends on FEATURE_AUDIO_OUTPUT
    range 0 1000
    default 100
    help
        A producer waits this long for a full priority lane before reporting a
        queue error. Zero makes submission non-blocking.

config AUDIO_OUTPUT_RENDER_TIMEOUT_MS
    int "Frame render timeout in milliseconds"
    depends on FEATURE_AUDIO_OUTPUT
    range 100 5000
    default 1000
    help
        Bounds how long a blocking submit waits for the mixer to send its exact
        frame to I2S. The bound prevents a stalled hardware path from hanging
        the playback queue indefinitely.

endmenu
```

## components/audio_pipeline/Kconfig
```kconfig
menu "Sprout feature modules"

config FEATURE_AUDIO_PIPELINE
    bool "Enable I2S microphone capture and speaker playback"
    default y
    depends on FEATURE_AUDIO_CODEC
    help
        Own the I2S peripheral for the microphone and speaker. Capture reads
        one 20 ms PCM frame at a time; playback writes one decoded frame at a
        time. The microphone is only enabled while a conversation is active, so
        a device never records in the background.

config AUDIO_PIPELINE_INPUT_ENABLED
    bool "Capture from the microphone"
    depends on FEATURE_AUDIO_PIPELINE
    default y

config AUDIO_PIPELINE_OUTPUT_ENABLED
    bool "Play through the speaker"
    depends on FEATURE_AUDIO_PIPELINE
    default y

config AUDIO_PIPELINE_I2S_PORT
    int "I2S peripheral index"
    depends on FEATURE_AUDIO_PIPELINE
    range 0 1
    default 0

config AUDIO_PIPELINE_BCLK_GPIO
    int "I2S bit clock GPIO"
    depends on FEATURE_AUDIO_PIPELINE
    range 0 48
    default 5

config AUDIO_PIPELINE_WS_GPIO
    int "I2S word select GPIO"
    depends on FEATURE_AUDIO_PIPELINE
    range 0 48
    default 4

config AUDIO_PIPELINE_DATA_IN_GPIO
    int "I2S microphone data GPIO"
    depends on FEATURE_AUDIO_PIPELINE && AUDIO_PIPELINE_INPUT_ENABLED
    range 0 48
    default 6

config AUDIO_PIPELINE_DATA_OUT_GPIO
    int "I2S speaker data GPIO"
    depends on FEATURE_AUDIO_PIPELINE && AUDIO_PIPELINE_OUTPUT_ENABLED
    range 0 48
    default 7

config AUDIO_PIPELINE_MCLK_GPIO
    int "I2S master clock GPIO, -1 when unused"
    depends on FEATURE_AUDIO_PIPELINE
    range -1 48
    default -1

config AUDIO_PIPELINE_DMA_DESCRIPTOR_COUNT
    int "I2S DMA descriptor count"
    depends on FEATURE_AUDIO_PIPELINE
    range 2 16
    default 6
    help
        Six descriptors absorb network jitter without adding noticeable
        latency. Higher values increase RAM use.

config AUDIO_PIPELINE_DMA_FRAME_COUNT
    int "PCM frames per I2S DMA descriptor"
    depends on FEATURE_AUDIO_PIPELINE
    range 32 512
    default 128

config AUDIO_PIPELINE_CAPTURE_TIMEOUT_MS
    int "Microphone read timeout in milliseconds"
    depends on FEATURE_AUDIO_PIPELINE && AUDIO_PIPELINE_INPUT_ENABLED
    range 20 2000
    default 200

config AUDIO_PIPELINE_PLAYBACK_TIMEOUT_MS
    int "Speaker write timeout in milliseconds"
    depends on FEATURE_AUDIO_PIPELINE && AUDIO_PIPELINE_OUTPUT_ENABLED
    range 20 2000
    default 500

endmenu
```

## components/battery_power/Kconfig
```kconfig
menu "Sprout feature modules"

config FEATURE_BATTERY_POWER
    bool "Enable battery and low-power policy"
    default n
    help
        Reads the battery gauge and charger pin, derives a bounded charge
        snapshot, and applies the guardian's low-battery warning, low-power
        entry and deep-sleep idle policy. The module only touches power state,
        so a mains-powered device never links it.

endmenu
```

## components/bluetooth_audio/Kconfig
```kconfig
menu "Sprout feature modules"

config FEATURE_BLUETOOTH_AUDIO
    bool "Enable Bluetooth audio speaker and pairing policy"
    default n
    help
        Runs the bounded Bluetooth audio policy and adapter state machine:
        opt-in speaker mode, guardian-gated pairing, an auto-reconnect flag, a
        preferred codec, a volume ceiling and a bounded adapter/disconnect
        state. A firmware profile without a Bluetooth radio simply does not
        link the component.

endmenu
```
