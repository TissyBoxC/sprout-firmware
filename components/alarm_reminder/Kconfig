## components/content_downloader/Kconfig
```kconfig
menu "Sprout feature modules"

config FEATURE_CONTENT_DOWNLOADER
    bool "Enable HTTPS content downloader"
    default n
    depends on FEATURE_CONTENT_LIBRARY && FEATURE_NETWORK_MANAGER
    help
        Streams content packages over HTTPS into the content partition, verifies
        SHA-256 against the library manifest, resumes interrupted transfers with
        Range requests when the server supports them, and publishes files
        atomically.

config CONTENT_DOWNLOADER_TIMEOUT_SECONDS
    int "Content transfer idle timeout in seconds"
    depends on FEATURE_CONTENT_DOWNLOADER
    range 10 600
    default 60

config CONTENT_DOWNLOADER_MAX_RETRIES
    int "Maximum retries for one failed content transfer"
    depends on FEATURE_CONTENT_DOWNLOADER
    range 0 8
    default 3

config CONTENT_DOWNLOADER_CHUNK_BYTES
    int "Streaming buffer size in bytes"
    depends on FEATURE_CONTENT_DOWNLOADER
    range 1024 32768
    default 8192

config CONTENT_PLAYBACK_CHUNK_FRAMES
    int "Frames queued per ambient content chunk"
    depends on FEATURE_CONTENT_DOWNLOADER && FEATURE_PLAYBACK_QUEUE
    range 1 32
    default 32

endmenu
```

## components/content_filter/Kconfig
```kconfig
menu "Sprout feature modules"

config FEATURE_CONTENT_FILTER
    bool "Enable child content filter"
    default y
    help
        Applies age-appropriate input and output moderation to every
        conversation turn. Returns stable reason codes so the gateway, parent
        app, and diagnostics can act without parsing log text.

endmenu
```

## components/content_library/Kconfig
```kconfig
menu "Sprout feature modules"

config FEATURE_CONTENT_LIBRARY
    bool "Enable offline content library"
    default n
    depends on FEATURE_CONFIG_STORE
    help
        Stores a bounded content index in NVS and exposes category and age-tier
        lookup for downloaded stories and learning assets. Package files live in
        the content partition; NVS only holds small metadata records.

config CONTENT_LIBRARY_INDEX_CAPACITY
    int "Maximum content packages kept in the local index"
    depends on FEATURE_CONTENT_LIBRARY
    range 8 128
    default 48
    help
        When the index is full, the oldest unpublished package is evicted.
        Withdrawn packages are always removed.

config CONTENT_LIBRARY_METADATA_KEY
    string "Configuration store key for the content index"
    depends on FEATURE_CONTENT_LIBRARY
    default "content_index"

endmenu
```
