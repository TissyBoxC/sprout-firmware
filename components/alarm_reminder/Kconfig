## components/bluetooth_audio_sync/Kconfig
```kconfig
menu "Sprout feature modules"

config FEATURE_BLUETOOTH_AUDIO_SYNC
    bool "Enable Bluetooth audio policy synchronisation"
    default y
    depends on FEATURE_BLUETOOTH_AUDIO && FEATURE_DEVICE_BINDING_CLIENT && FEATURE_NETWORK_MANAGER && FEATURE_TIME_SYNC
    help
        Fetches the family Bluetooth audio policy and applies it, keeping a
        device's speaker, pairing, codec and volume ceiling consistent with the
        parent app.

config BLUETOOTH_AUDIO_SYNC_INTERVAL_SECONDS
    int "Bluetooth audio policy sync interval in seconds"
    depends on FEATURE_BLUETOOTH_AUDIO_SYNC
    range 60 86400
    default 1800

config BLUETOOTH_AUDIO_SYNC_RETRY_INTERVAL_SECONDS
    int "Bluetooth audio policy sync retry interval while offline"
    depends on FEATURE_BLUETOOTH_AUDIO_SYNC
    range 5 300
    default 15

endmenu
```

## components/button_input/Kconfig
```kconfig
menu "Sprout feature modules"

config FEATURE_BUTTON_INPUT
    bool "Enable physical key input"
    default y
    help
        Own the debounced physical key input path. GPIO interrupts only wake
        a task that then runs the debounce and gesture state machine. The
        component exposes short, long, very-long, and double press gestures.

config BUTTON_INPUT_PRIMARY_GPIO
    int "Primary function button GPIO"
    depends on FEATURE_BUTTON_INPUT
    range 0 48
    default 0
    help
        Boot button on the current ESP32-S3 N16R8 profile. The pin is sampled
        active-low by default, and a product profile may override it when the
        enclosure uses a different function key.

config BUTTON_INPUT_PRIMARY_ACTIVE_LOW
    bool "Primary function button is active-low"
    depends on FEATURE_BUTTON_INPUT
    default y

config BUTTON_INPUT_SECONDARY_ENABLED
    bool "Enable the secondary button"
    depends on FEATURE_BUTTON_INPUT
    default y

config BUTTON_INPUT_SECONDARY_GPIO
    int "Secondary button GPIO"
    depends on FEATURE_BUTTON_INPUT && BUTTON_INPUT_SECONDARY_ENABLED
    range 0 48
    default 1
    help
        Avoid I2S GPIO 4-7 and the N16R8 flash/PSRAM pins. Change this value
        in the product profile when the board routes a different key.

config BUTTON_INPUT_SECONDARY_ACTIVE_LOW
    bool "Secondary button is active-low"
    depends on FEATURE_BUTTON_INPUT && BUTTON_INPUT_SECONDARY_ENABLED
    default y

config BUTTON_INPUT_SHORT_PRESS_MS
    int "Short press threshold in milliseconds"
    depends on FEATURE_BUTTON_INPUT
    range 20 500
    default 50

config BUTTON_INPUT_DEBOUNCE_MS
    int "Debounce time in milliseconds"
    depends on FEATURE_BUTTON_INPUT
    range 5 100
    default 25

config BUTTON_INPUT_LONG_PRESS_MS
    int "Long press threshold in milliseconds"
    depends on FEATURE_BUTTON_INPUT
    range 200 10000
    default 1200

config BUTTON_INPUT_VERY_LONG_PRESS_MS
    int "Very-long press threshold in milliseconds"
    depends on FEATURE_BUTTON_INPUT
    range 1000 30000
    default 5000
    help
        Factory reset gesture threshold. The application owns the reset
        action and must still require an explicit user-visible confirmation.

config BUTTON_INPUT_DOUBLE_PRESS_MS
    int "Double press window in milliseconds"
    depends on FEATURE_BUTTON_INPUT
    range 100 1500
    default 350

config BUTTON_INPUT_TASK_STACK_SIZE
    int "Button task stack size in bytes"
    depends on FEATURE_BUTTON_INPUT
    range 2048 8192
    default 3072

config BUTTON_INPUT_TASK_PRIORITY
    int "Button task priority"
    depends on FEATURE_BUTTON_INPUT
    range 1 20
    default 4
    help
        The task only runs after a GPIO wake-up or a bounded gesture timeout,
        so it stays below the audio and network workers.

endmenu
```

## components/camera_capture/Kconfig
```kconfig
menu "Sprout feature modules"

config FEATURE_CAMERA_CAPTURE
    bool "Enable camera capture pipeline"
    depends on CAPABILITY_CAMERA
    default n
    help
        Enables the camera capture lifecycle and the OV2640 sensor driver behind
        it. Capture always requires explicit guardian consent for image upload;
        without consent the sensor is never started. Firmware images built
        without the camera capability compile the component out entirely, and
        the sensor is only started when a pin set is configured below.

config CAMERA_SENSOR_OV2640
    bool "Use the OV2640 image sensor"
    depends on FEATURE_CAMERA_CAPTURE
    default y
    help
        The OV2640 is the sensor on the current carrier board. Only one sensor
        model may be selected, because the driver binds its register set at
        initialization.

config CAMERA_PIN_PWDN
    int "Power-down GPIO (-1 when the board ties it low)"
    depends on FEATURE_CAMERA_CAPTURE
    default 38
    help
        Set this to -1 when the carrier board pulls PWDN to ground permanently.

config CAMERA_PIN_RESET
    int "Reset GPIO (-1 when the board ties it high)"
    depends on FEATURE_CAMERA_CAPTURE
    default -1

config CAMERA_PIN_XCLK
    int "Master clock GPIO"
    depends on FEATURE_CAMERA_CAPTURE
    default 15

config CAMERA_PIN_SIOD
    int "SCCB data GPIO"
    depends on FEATURE_CAMERA_CAPTURE
    default 4

config CAMERA_PIN_SIOC
    int "SCCB clock GPIO"
    depends on FEATURE_CAMERA_CAPTURE
    default 5

config CAMERA_PIN_D7
    int "Pixel data D7 GPIO"
    depends on FEATURE_CAMERA_CAPTURE
    default 16

config CAMERA_PIN_D6
    int "Pixel data D6 GPIO"
    depends on FEATURE_CAMERA_CAPTURE
    default 17

config CAMERA_PIN_D5
    int "Pixel data D5 GPIO"
    depends on FEATURE_CAMERA_CAPTURE
    default 18

config CAMERA_PIN_D4
    int "Pixel data D4 GPIO"
    depends on FEATURE_CAMERA_CAPTURE
    default 12

config CAMERA_PIN_D3
    int "Pixel data D3 GPIO"
    depends on FEATURE_CAMERA_CAPTURE
    default 10

config CAMERA_PIN_D2
    int "Pixel data D2 GPIO"
    depends on FEATURE_CAMERA_CAPTURE
    default 8

config CAMERA_PIN_D1
    int "Pixel data D1 GPIO"
    depends on FEATURE_CAMERA_CAPTURE
    default 9

config CAMERA_PIN_D0
    int "Pixel data D0 GPIO"
    depends on FEATURE_CAMERA_CAPTURE
    default 11

config CAMERA_PIN_VSYNC
    int "Vertical sync GPIO"
    depends on FEATURE_CAMERA_CAPTURE
    default 6

config CAMERA_PIN_HREF
    int "Horizontal reference GPIO"
    depends on FEATURE_CAMERA_CAPTURE
    default 7

config CAMERA_PIN_PCLK
    int "Pixel clock GPIO"
    depends on FEATURE_CAMERA_CAPTURE
    default 13

config CAMERA_XCLK_FREQUENCY_HZ
    int "Master clock frequency in Hz"
    depends on FEATURE_CAMERA_CAPTURE
    default 20000000
    range 10000000 24000000

config CAMERA_FRAME_QUALITY
    int "JPEG quality, lower is better and larger"
    depends on FEATURE_CAMERA_CAPTURE
    default 12
    range 6 30
    help
        A still is one JPEG frame. The quality stays mid-range because a care
        view still only has to be legible, and a smaller frame keeps a mobile
        uplink from stalling.

config CAMERA_FRAME_WIDTH
    int "JPEG frame width in pixels"
    depends on FEATURE_CAMERA_CAPTURE
    default 640

config CAMERA_FRAME_HEIGHT
    int "JPEG frame height in pixels"
    depends on FEATURE_CAMERA_CAPTURE
    default 480

endmenu
```

## components/camera_vision/Kconfig
```kconfig
menu "Sprout feature modules"

config FEATURE_CAMERA_VISION
    bool "Enable camera vision tasks"
    depends on FEATURE_CAMERA_CAPTURE
    default n
    help
        Enables on-device vision tasks (object recognition, picture-book
        recognition, and photo Q&A) that consume camera_capture frames. Every
        task re-checks guardian image-upload consent; results carry only
        bounded symbolic labels.

endmenu
```

## components/care_view/Kconfig
```kconfig
menu "Sprout feature modules"

# Secure by default: a care view turns on a camera in a child's room, so the
# capability stays off until the product enables it for the profile AND a
# guardian has explicitly turned it on in the parent app. The device additionally
# refuses to start unless it can show a visible and audible indication.
config FEATURE_CARE_VIEW
    bool "Enable guardian live camera view"
    default n
    depends on FEATURE_CAMERA_CAPTURE && FEATURE_SCREEN_SURFACE && FEATURE_AUDIO_OUTPUT && FEATURE_PROMPT_TONE && FEATURE_BUTTON_INPUT && FEATURE_DEVICE_MESSAGE && FEATURE_DEVICE_IDENTITY
    help
        Lets a guardian open a short live view of the device camera from the
        parent app. The device shows an on-screen notice and plays a prompt when
        a view starts, refuses to start if either is unavailable, stops the view
        when the child presses the button, and enforces the session deadline on
        its own instead of trusting the platform. Frames are sent over the relay
        and are never written to flash, the SD card, or the logs.

config CARE_VIEW_MAX_SECONDS
    int "Longest single care view, in seconds"
    depends on FEATURE_CARE_VIEW
    range 30 300
    default 180
    help
        Hard upper bound the device enforces regardless of what the platform
        asks for. A camera left running in a child's room is the failure mode
        this limit exists to prevent.

config CARE_VIEW_FRAME_INTERVAL_MS
    int "Milliseconds between captured frames"
    depends on FEATURE_CARE_VIEW
    range 200 5000
    default 500
    help
        Lower values give a smoother view at the cost of bandwidth and power. The
        relay may serve a slower rate than this, never a faster one.

config CARE_VIEW_MAX_FRAME_BYTES
    int "Largest single frame in bytes"
    depends on FEATURE_CARE_VIEW
    range 8192 262144
    default 131072
    help
        A frame larger than this is dropped rather than sent, so one bad capture
        cannot stall the uplink or exhaust memory.

config CARE_VIEW_MAX_SESSION_SECONDS
    int "Longest accepted session, in seconds"
    depends on FEATURE_CARE_VIEW
    range 30 300
    default 180
    help
        A session whose deadline is further out than this is clamped, so the
        platform cannot extend a view beyond the device's own policy.

endmenu
```

## components/cellular_4g/Kconfig
```kconfig
menu "Sprout feature modules"

config FEATURE_CELLULAR_4G
    bool "Enable cellular 4G, eSIM and data policy"
    default n
    help
        Applies the guardian's cellular policy (enable, roaming, cellular vs
        Wi-Fi preference, monthly data quota, low-quota warning, metered upload
        limit, remote wake and keepalive) and records eSIM and modem status.
        The module only touches connectivity state, so a Wi-Fi-only device never
        links it.

endmenu
```

## components/cellular_sync/Kconfig
```kconfig
menu "Sprout feature modules"

config FEATURE_CELLULAR_SYNC
    bool "Enable cellular policy and status synchronisation"
    default n
    depends on FEATURE_CELLULAR_4G && FEATURE_DEVICE_BINDING_CLIENT && FEATURE_NETWORK_MANAGER && FEATURE_TIME_SYNC
    help
        Reads the family cellular policy, applies it to the modem and reports
        the live eSIM and signal status back to the platform. A Wi-Fi-only
        image never links this component.

config CELLULAR_SYNC_INTERVAL_SECONDS
    int "Cellular policy sync interval in seconds"
    depends on FEATURE_CELLULAR_SYNC
    range 60 86400
    default 900

config CELLULAR_SYNC_RETRY_INTERVAL_SECONDS
    int "Cellular sync retry interval while offline"
    depends on FEATURE_CELLULAR_SYNC
    range 5 300
    default 15

endmenu
```

## components/child_prompt_profile/Kconfig
```kconfig
menu "Sprout feature modules"

config FEATURE_CHILD_PROMPT_PROFILE
    bool "Enable local child prompt profile"
    default n
    depends on FEATURE_CONFIG_STORE
    help
        Persist the child's age tier and mirror the guardian content allowlist
        so the device can gate local prompts and label a voice session with the
        active content level. The platform child profile remains authoritative.

endmenu
```

## components/cloud_auth/Kconfig
```kconfig
menu "Sprout feature modules"

config FEATURE_CLOUD_AUTH
    bool "Enable cloud authentication lifecycle"
    default y
    depends on FEATURE_DEVICE_BINDING_CLIENT && FEATURE_NETWORK_MANAGER && FEATURE_TIME_SYNC
    help
        Refreshes the device session before expiry, clears a revoked session
        after a platform rejection, and blocks authenticated work until the
        device clock is trusted.

config CLOUD_AUTH_REFRESH_MARGIN_SECONDS
    int "Seconds before expiry to refresh the device session"
    depends on FEATURE_CLOUD_AUTH
    range 30 1800
    default 300

endmenu
```

## components/companionship/Kconfig
```kconfig
menu "Sprout feature modules"

config FEATURE_COMPANIONSHIP
    bool "Enable local companionship encouragement"
    default y
    help
        Provides a local, bounded encouragement reply keyed to a child's
        emotion so the device stays kind and responsive when the AI reply is
        unavailable. It pairs with the growth record and habit reminder caches
        to complete the offline companionship loop.

endmenu
```

## components/config_store/Kconfig
```kconfig
menu "Sprout feature modules"

config FEATURE_CONFIG_STORE
    bool "Enable configuration store"
    default y
    help
        Store Wi-Fi credentials, provisioning state, and small runtime
        settings in NVS. This module never logs or returns secrets. Production
        images must enable NVS encryption for the target partition.

config CONFIG_STORE_LARGE_PARTITION
    string "NVS partition for large configuration blobs"
    depends on FEATURE_CONFIG_STORE
    default "nvs_data"
    help
        Separate NVS partition used for large blobs such as the cached
        English course catalog and UI text package. Keeping these out of the
        default nvs partition lets small credential records stay in the
        legacy 24 KB partition while large caches have room to grow.

endmenu
```

## components/connectivity_policy_sync/Kconfig
```kconfig
menu "Sprout feature modules"

config FEATURE_CONNECTIVITY_POLICY_SYNC
    bool "Enable Wi-Fi-path connectivity policy synchronisation"
    default y
    depends on FEATURE_CONNECTIVITY_REPORT && FEATURE_DEVICE_BINDING_CLIENT && FEATURE_NETWORK_MANAGER && FEATURE_TIME_SYNC && !FEATURE_CELLULAR_SYNC
    help
        Fetches the family connectivity policy on a Wi-Fi-only image and
        persists the applied revision, so connectivity_report can report the
        revision the device actually runs instead of a hardcoded zero. A build
        with the modem stack uses cellular_sync as the single policy source and
        leaves this component out.

config CONNECTIVITY_POLICY_SYNC_INTERVAL_SECONDS
    int "Connectivity policy sync interval in seconds"
    depends on FEATURE_CONNECTIVITY_POLICY_SYNC
    range 300 86400
    default 900

config CONNECTIVITY_POLICY_SYNC_RETRY_INTERVAL_SECONDS
    int "Connectivity policy sync retry interval while offline"
    depends on FEATURE_CONNECTIVITY_POLICY_SYNC
    range 5 300
    default 15

endmenu
```

## components/connectivity_report/Kconfig
```kconfig
menu "Sprout feature modules"

config FEATURE_CONNECTIVITY_REPORT
    bool "Report the live network bearer and signal to the platform"
    default n
    depends on FEATURE_DEVICE_BINDING_CLIENT && FEATURE_NETWORK_MANAGER && FEATURE_NETWORK_QUALITY && FEATURE_TIME_SYNC
    help
        Reports the device's active network bearer and measured signal
        percentage so the guardian overview shows whether the device is on
        Wi-Fi or offline. The device has no cellular modem in this image, so it
        reports the Wi-Fi bearer and a bounded signal percentage.

config CONNECTIVITY_REPORT_INTERVAL_SECONDS
    int "Connectivity report interval in seconds"
    depends on FEATURE_CONNECTIVITY_REPORT
    range 300 86400
    default 900

config CONNECTIVITY_REPORT_RETRY_INTERVAL_SECONDS
    int "Connectivity report retry interval while offline"
    depends on FEATURE_CONNECTIVITY_REPORT
    range 5 300
    default 15

endmenu
```
