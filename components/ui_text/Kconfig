## components/ui_text/Kconfig
```kconfig
menu "Sprout feature modules"

config FEATURE_UI_TEXT
    bool "Enable remote UI text"
    default n
    depends on FEATURE_CONFIG_STORE
    help
        Enable the optional remote UI text module. When disabled, UI text
        related source files and dependencies are not linked.

config UI_TEXT_ENTRY_CAPACITY
    int "Maximum text entries kept in the active package"
    depends on FEATURE_UI_TEXT
    range 8 256
    default 128
    help
        Bounds the RAM and NVS footprint of the active remote package. A
        package with more entries than this is rejected so the device keeps
        rendering its last known good text.

config UI_TEXT_METADATA_KEY
    string "Configuration store key for the active UI text package"
    depends on FEATURE_UI_TEXT
    default "ui_text_index"

endmenu
```

## components/ui_text_sync/Kconfig
```kconfig
menu "Sprout feature modules"

config FEATURE_UI_TEXT_SYNC
    bool "Enable remote UI text synchronisation"
    default n
    depends on FEATURE_UI_TEXT && FEATURE_DEVICE_BINDING_CLIENT && FEATURE_NETWORK_MANAGER && FEATURE_TIME_SYNC
    help
        Pulls published device_firmware UI text packages and applies the newest
        published copy, so the device renders the same copy the platform and
        parent app show. A withdrawal reverts the device to built-in text.

config UI_TEXT_SYNC_LANGUAGE
    string "Device language tag for remote UI text"
    depends on FEATURE_UI_TEXT_SYNC
    default "zh-CN"
    help
        Only packages whose language matches this BCP-47-ish tag are applied.

config UI_TEXT_SYNC_INTERVAL_SECONDS
    int "UI text sync interval in seconds"
    depends on FEATURE_UI_TEXT_SYNC
    range 300 86400
    default 3600

config UI_TEXT_SYNC_RETRY_INTERVAL_SECONDS
    int "UI text sync retry interval while offline"
    depends on FEATURE_UI_TEXT_SYNC
    range 5 300
    default 15

endmenu
```

## components/usage_ledger/Kconfig
```kconfig
menu "Sprout feature modules"

config FEATURE_USAGE_LEDGER
    bool "Enable local usage ledger"
    default y
    depends on FEATURE_CONFIG_STORE && FEATURE_TIME_SYNC
    help
        Persists local-day active seconds, conversation and content totals,
        per-category usage, and blocked counters. Completed days remain
        pending until the platform confirms the idempotent device+date upload.

endmenu
```

## components/version_info/Kconfig
```kconfig
menu "Sprout feature modules"

config FEATURE_VERSION_INFO
    bool "Enable version info"
    default y
    help
        Expose firmware, hardware, and protocol versions shared with the
        platform contract.

config FIRMWARE_PROTOCOL_VERSION
    string "Device protocol version"
    depends on FEATURE_VERSION_INFO
    default "1.0.0"

config FIRMWARE_SCHEMA_VERSION
    string "Device contract schema version"
    depends on FEATURE_VERSION_INFO
    default "1.0.0"

endmenu
```

## components/video_companion_report/Kconfig
```kconfig
menu "Sprout feature modules"

config FEATURE_VIDEO_COMPANION_REPORT
    bool "Report the live video-companionship status to the platform"
    default y
    depends on FEATURE_VIDEO_SESSION && FEATURE_DEVICE_BINDING_CLIENT && FEATURE_NETWORK_MANAGER && FEATURE_TIME_SYNC
    help
        Reports the device's live call state and media permissions so the
        guardian video-companion capability view converges. Without a producer
        the platform never receives a device status and every device reads as
        unsupported.

config VIDEO_COMPANION_REPORT_INTERVAL_SECONDS
    int "Video-companion status report interval in seconds"
    depends on FEATURE_VIDEO_COMPANION_REPORT
    range 300 86400
    default 3600

config VIDEO_COMPANION_REPORT_RETRY_INTERVAL_SECONDS
    int "Video-companion status report retry interval while offline"
    depends on FEATURE_VIDEO_COMPANION_REPORT
    range 5 300
    default 15

endmenu
```

## components/video_session/Kconfig
```kconfig
menu "Sprout feature modules"

config FEATURE_VIDEO_SESSION
    bool "Enable video call and companionship session"
    default n
    help
        Runs the bounded video session state machine, enforces the guardian
        camera and microphone permission, keeps a child consent gate and ends a
        call immediately when a permission is revoked. The default policy keeps
        capture off until a guardian enables it, so an audio-only body never
        links the component.

endmenu
```

## components/video_session_sync/Kconfig
```kconfig
menu "Sprout feature modules"

config FEATURE_VIDEO_SESSION_SYNC
    bool "Enable video-session policy synchronisation"
    default y
    depends on FEATURE_VIDEO_SESSION && FEATURE_DEVICE_BINDING_CLIENT && FEATURE_NETWORK_MANAGER && FEATURE_TIME_SYNC
    help
        Fetches the family video-session policy and applies it, keeping a
        device's camera and microphone permissions, child consent gate, quality
        floor, ring timeout and session ceiling consistent with the parent app.

config VIDEO_SESSION_SYNC_INTERVAL_SECONDS
    int "Video-session policy sync interval in seconds"
    depends on FEATURE_VIDEO_SESSION_SYNC
    range 60 86400
    default 3600

config VIDEO_SESSION_SYNC_RETRY_INTERVAL_SECONDS
    int "Video-session policy sync retry interval while offline"
    depends on FEATURE_VIDEO_SESSION_SYNC
    range 5 300
    default 15

endmenu
```

## components/vision_sync/Kconfig
```kconfig
menu "Sprout feature modules"

config FEATURE_VISION_SYNC
    bool "Enable camera vision task synchronisation"
    default n
    depends on FEATURE_CAMERA_VISION && FEATURE_DEVICE_BINDING_CLIENT && FEATURE_NETWORK_MANAGER && FEATURE_TIME_SYNC
    help
        Fetches guardian vision tasks from the platform, runs the on-device
        inference provider and reports bounded results or failures back. A
        build without an inference provider still drains the queue but reports
        each task as unsupported instead of fabricating a recognition result.

config VISION_SYNC_INTERVAL_SECONDS
    int "Vision task poll interval in seconds"
    depends on FEATURE_VISION_SYNC
    range 15 3600
    default 30

config VISION_SYNC_RETRY_INTERVAL_SECONDS
    int "Vision task sync retry interval while offline"
    depends on FEATURE_VISION_SYNC
    range 5 300
    default 15

config VISION_SYNC_MAX_TASKS_PER_CYCLE
    int "Maximum vision tasks handled per poll"
    depends on FEATURE_VISION_SYNC
    range 1 16
    default 4

endmenu
```

## components/voice_intercom/Kconfig
```kconfig
menu "Sprout feature modules"

# Secure by default: a guardian call needs an explicit accept on the device, so
# the whole capability stays off until the parent app ships the call commands
# and the product enables it for the profile.
config FEATURE_VOICE_INTERCOM
    bool "Enable guardian voice intercom calls"
    default n
    depends on FEATURE_VOICE_SESSION && FEATURE_BUTTON_INPUT && FEATURE_DEVICE_BINDING_CLIENT && FEATURE_DEVICE_IDENTITY && FEATURE_NETWORK_MANAGER && FEATURE_DEVICE_MESSAGE
    help
        Lets a guardian call the device from the parent app. The device rings
        on the screen and speaker, captures no audio while ringing, and starts
        the realtime voice session only after the child accepts with a
        physical button. A decline, a hangup, the ring timeout, the maximum
        call duration and the guardian side hanging up all release the audio
        path immediately.

config VOICE_INTERCOM_RING_TIMEOUT_SECONDS
    int "Seconds the device rings before the call is declined automatically"
    depends on FEATURE_VOICE_INTERCOM
    range 10 120
    default 30

config VOICE_INTERCOM_MAX_CALL_SECONDS
    int "Maximum duration of one guardian call in seconds"
    depends on FEATURE_VOICE_INTERCOM
    range 30 1800
    default 300
    help
        Hard upper bound enforced on the device, independent of the server or
        the guardian. When it expires the call ends exactly like a hangup.

endmenu
```

## components/voice_session/Kconfig
```kconfig
menu "Sprout feature modules"

config FEATURE_VOICE_SESSION
    bool "Enable realtime voice session over WSS"
    default n
    depends on FEATURE_AUDIO_CODEC && FEATURE_AUDIO_PIPELINE && FEATURE_AUDIO_INPUT && FEATURE_PLAYBACK_QUEUE && FEATURE_DEVICE_BINDING_CLIENT && FEATURE_DEVICE_IDENTITY && FEATURE_NETWORK_MANAGER
    help
        Connect to the voice gateway over WSS, stream microphone audio, play
        replies, and drive wake-triggered, barge-in, and continuous multi-turn
        conversation. Certificate validation is always enabled and cleartext
        WebSocket is rejected unless the debug-only insecure flag is set.

config VOICE_SESSION_ENDPOINT
    string "Voice gateway WebSocket URL"
    depends on FEATURE_VOICE_SESSION
    default "wss://voice.clarkhub.cn/v1/voice"
    help
        Must use wss:// so TLS certificate validation stays enabled. The device
        token is sent in the Authorization header and never in the query string.

config VOICE_SESSION_ALLOW_INSECURE_WS
    bool "Allow cleartext ws:// for local debugging"
    depends on FEATURE_VOICE_SESSION
    default n
    help
        Development only. Even when set, a release image refuses ws:// because
        the check is compiled out under the release optimization level.

config FEATURE_VOICE_DUPLEX
    bool "Enable full-duplex, barge-in, and continuous conversation"
    depends on FEATURE_VOICE_SESSION
    default y
    help
        Keep capture active while playback is running, feed the playback signal
        into the echo reference, detect child barge-in without treating the
        speaker output as speech, and keep a multi-turn session alive until the
        idle window expires. Disabling this returns the session to the legacy
        half-duplex-compatible behavior.

config VOICE_SESSION_IDLE_TIMEOUT_MS
    int "Continuous conversation idle timeout in milliseconds"
    depends on FEATURE_VOICE_DUPLEX
    range 3000 60000
    default 12000
    help
        After the last user speech or gateway activity, the device keeps the
        conversation session open for this window. A timeout returns it to the
        wake-word state without requiring a new wake word per turn.

config VOICE_SESSION_BARGE_IN_THRESHOLD_Q15
    int "Microphone energy threshold for barge-in in Q15"
    depends on FEATURE_VOICE_DUPLEX
    range 1 32767
    default 1200
    help
        A captured frame above this level can start the barge-in window. The
        pure state machine still requires a stable non-echo speech run before
        interrupting the assistant.

config VOICE_SESSION_ECHO_GUARD_THRESHOLD_Q15
    int "Echo-reference guard threshold in Q15"
    depends on FEATURE_VOICE_DUPLEX
    range 1 32767
    default 1800
    help
        A loud frame whose level is close to the current playback reference is
        treated as acoustic echo and does not trigger barge-in.

config VOICE_SESSION_BARGE_IN_FRAMES
    int "Consecutive non-echo speech frames required for barge-in"
    depends on FEATURE_VOICE_DUPLEX
    range 1 20
    default 2
    help
        Two 20 ms frames (40 ms) rejects clicks and speaker transients while
        keeping the interruption responsive.

config VOICE_SESSION_PLAYBACK_ACTIVITY_HOLD_MS
    int "Playback activity hold in milliseconds"
    depends on FEATURE_VOICE_DUPLEX
    range 0 2000
    default 300
    help
        Keeps the output/reference activity observable briefly after the last
        playback frame so a late echo cannot be mistaken for a child interrupt.

endmenu
```

## components/voice_wake/Kconfig
```kconfig
menu "Sprout feature modules"

config FEATURE_VOICE_WAKE
    bool "Enable always-on local voice wake detection"
    default y
    depends on FEATURE_AUDIO_PIPELINE
    help
        Detect the configured wake word locally with ESP-SR AFE and WakeNet,
        or with a deterministic energy detector for CI and removable-module
        builds. The microphone starts disabled and is enabled only while the
        wake engine is armed.

choice VOICE_WAKE_BACKEND
    prompt "Voice wake detector backend"
    depends on FEATURE_VOICE_WAKE
    default VOICE_WAKE_BACKEND_ESP_SR
    help
        ESP-SR is the production detector and requires the model partition and
        model-loading options documented in the component README. The
        deterministic backend uses bounded energy and zero-crossing evidence
        so CI and removal checks can exercise the same event contract without
        model data or platform DSP.

config VOICE_WAKE_BACKEND_ESP_SR
    bool "ESP-SR AFE + WakeNet"

config VOICE_WAKE_BACKEND_DETERMINISTIC
    bool "Deterministic energy detector"

endchoice

choice VOICE_WAKE_AFE_MODE
    prompt "ESP-SR AFE operating mode"
    depends on FEATURE_VOICE_WAKE && VOICE_WAKE_BACKEND_ESP_SR
    default VOICE_WAKE_AFE_MODE_LOW_COST
    help
        Low-cost mode keeps wake detection resident with a smaller compute and
        memory footprint. High-performance mode can improve recognition in
        difficult acoustics at the cost of CPU and PSRAM.

config VOICE_WAKE_AFE_MODE_LOW_COST
    bool "Low cost"

config VOICE_WAKE_AFE_MODE_HIGH_PERF
    bool "High performance"

endchoice

config VOICE_WAKE_MIN_CONFIDENCE_MILLI
    int "Minimum accepted detection confidence (0..1000)"
    depends on FEATURE_VOICE_WAKE
    range 0 1000
    default 600
    help
        Detections below this confidence are rejected and counted. ESP-SR
        reports the configured WakeNet threshold because its fetch result does
        not expose a finer confidence value.

config VOICE_WAKE_COOLDOWN_MS
    int "Detection cooldown in milliseconds"
    depends on FEATURE_VOICE_WAKE
    range 0 60000
    default 2000
    help
        Suppresses a second event for this long after an accepted detection.

config VOICE_WAKE_PLAYBACK_IGNORE_MS
    int "Ignore window after speaker playback in milliseconds"
    depends on FEATURE_VOICE_WAKE
    range 0 10000
    default 300
    help
        Prevents the speaker tail from immediately retriggering the detector.

config VOICE_WAKE_TASK_STACK_SIZE
    int "Wake capture task stack size in bytes"
    depends on FEATURE_VOICE_WAKE
    range 4096 32768
    default 8192

config VOICE_WAKE_TASK_PRIORITY
    int "Wake capture task priority"
    depends on FEATURE_VOICE_WAKE
    range 1 24
    default 7

config VOICE_WAKE_FRAME_TIMEOUT_MS
    int "Microphone frame timeout in milliseconds"
    depends on FEATURE_VOICE_WAKE
    range 20 2000
    default 200

config VOICE_WAKE_WAKENET_THRESHOLD_MILLI
    int "WakeNet threshold (0.4..0.9999 represented as milli)"
    depends on FEATURE_VOICE_WAKE && VOICE_WAKE_BACKEND_ESP_SR
    range 400 999
    default 700
    help
        WakeNet accepts thresholds from 0.4 to 0.9999. This build exposes
        three decimal places, which is the precision used by the model
        metadata and avoids floating-point Kconfig values.

config VOICE_WAKE_DETERMINISTIC_RMS_THRESHOLD
    int "Deterministic detector RMS threshold"
    depends on FEATURE_VOICE_WAKE && VOICE_WAKE_BACKEND_DETERMINISTIC
    range 1 32767
    default 900
    help
        A candidate must exceed this RMS level and show a speech-like
        zero-crossing rate before it can produce a wake event.

config VOICE_WAKE_DETERMINISTIC_MIN_RUN_FRAMES
    int "Deterministic detector run length in frames"
    depends on FEATURE_VOICE_WAKE && VOICE_WAKE_BACKEND_DETERMINISTIC
    range 1 100
    default 4
    help
        Four consecutive 20 ms frames is 80 ms of sustained speech-like
        evidence, which rejects isolated clicks and impulse noise.

endmenu
```
