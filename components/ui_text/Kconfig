## components/volume_control/Kconfig
```kconfig
menu "Sprout feature modules"

config FEATURE_VOLUME_CONTROL
    bool "Enable speaker volume control"
    default y
    help
        Own the speaker volume and the guardian maximum in percent. Persist the
        value through config_store when that module is present, and clamp every
        change to the policy limit so a loud request can never exceed it.

config VOLUME_CONTROL_DEFAULT_PERCENT
    int "Default volume percent on first boot"
    depends on FEATURE_VOLUME_CONTROL
    range 0 100
    default 40

config VOLUME_CONTROL_MAX_PERCENT
    int "Default maximum volume percent"
    depends on FEATURE_VOLUME_CONTROL
    range 0 100
    default 70
    help
        Conservative ceiling until the platform delivers the family policy.
        Lowering this value immediately reduces the live volume.

endmenu
```

## components/wake_feedback/Kconfig
```kconfig
menu "Sprout feature modules"

config FEATURE_WAKE_FEEDBACK
    bool "Enable wake feedback"
    default y
    depends on FEATURE_VOICE_WAKE
    help
        Turn one accepted local wake event into immediate device feedback:
        play the short wake cue, show the listening indicator, and record the
        bounded wake interaction event for the next authenticated heartbeat.
        Raw audio and wake confidence are not persisted.

endmenu
```

## components/wearable_location/Kconfig
```kconfig
menu "Sprout feature modules"

config FEATURE_WEARABLE_LOCATION
    bool "Enable wearable location, geofence and SOS"
    default n
    help
        Runs the bounded wearable location policy, evaluates a geofence and
        latches an SOS until it is cancelled. The default policy keeps sampling
        off and requires a guardian permission, so a body without a wearable
        sensor simply does not link the component.

endmenu
```

## components/wearable_sync/Kconfig
```kconfig
menu "Sprout feature modules"

config FEATURE_WEARABLE_SYNC
    bool "Enable wearable location policy and SOS synchronisation"
    default n
    depends on FEATURE_WEARABLE_LOCATION && FEATURE_DEVICE_BINDING_CLIENT && FEATURE_NETWORK_MANAGER && FEATURE_TIME_SYNC
    help
        Reads the family location policy, applies it locally and reports the
        device's position and SOS trigger back to the platform. A build without
        a position provider applies the policy but never uploads a position.

config WEARABLE_SYNC_INTERVAL_SECONDS
    int "Wearable location sync interval in seconds"
    depends on FEATURE_WEARABLE_SYNC
    range 30 86400
    default 300

config WEARABLE_SYNC_RETRY_INTERVAL_SECONDS
    int "Wearable sync retry interval while offline"
    depends on FEATURE_WEARABLE_SYNC
    range 5 300
    default 15

endmenu
```
