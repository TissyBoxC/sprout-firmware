## components/factory_reset/Kconfig
```kconfig
menu "Sprout feature modules"

config FEATURE_FACTORY_RESET
    bool "Enable guarded local factory reset"
    default y
    depends on FEATURE_MODULE_REGISTRY
    help
        Require an explicit second confirmation before erasing the device's own
        configuration and credentials. A pending request expires after a
        bounded timeout. The reset never erases application or data partitions
        other than the configured NVS partition.

config FACTORY_RESET_PENDING_TIMEOUT_SECONDS
    int "Pending request timeout in seconds"
    depends on FEATURE_FACTORY_RESET
    range 1 300
    default 10
    help
        A bare request is rejected once this many seconds pass without an
        explicit confirmation, so an accidental gesture cannot leave the
        device armed indefinitely.

config FACTORY_RESET_LOCAL_CONFIRM_WINDOW_SECONDS
    int "Local confirmation window in seconds"
    depends on FEATURE_FACTORY_RESET
    range 1 120
    default 5
    help
        After a local request, the secondary button must be short-pressed
        within this window to confirm the erase. The primary button cancels
        while the request is armed. This is separate from the overall pending
        request timeout so an accidental gesture cannot erase by itself.

config FACTORY_RESET_NVS_PARTITION
    string "NVS partition erased by factory reset"
    depends on FEATURE_FACTORY_RESET
    default "nvs"
    help
        Label of the device-owned NVS partition. Only this partition is
        erased. Keep it identical to the partition used by config_store and
        device identity so credentials do not remain on the device.

endmenu
```

## components/family_linkage/Kconfig
```kconfig
menu "Sprout feature modules"

config FEATURE_FAMILY_LINKAGE
    bool "Enable family linkage, device groups and content sync"
    default n
    help
        Runs the bounded family-linkage policy, evaluates message routing scope
        and resolves content-sync conflicts by version. A lone device is a valid
        family of one, so a body without a second device simply does not link
        the component.

endmenu
```

## components/favorites/Kconfig
```kconfig
menu "Sprout feature modules"

config FEATURE_FAVORITES
    bool "Enable guardian content favourites"
    default y
    help
        Keeps a bounded, newest-first index of guardian-bookmarked content
        package ids persisted across restarts so the device can offer a
        quick-play menu for favourites and stay in sync with the parent app.

endmenu
```

## components/favorites_sync/Kconfig
```kconfig
menu "Sprout feature modules"

config FEATURE_FAVORITES_SYNC
    bool "Enable guardian favourites synchronisation"
    default y
    depends on FEATURE_FAVORITES && FEATURE_DEVICE_BINDING_CLIENT && FEATURE_NETWORK_MANAGER && FEATURE_TIME_SYNC
    help
        Fetches the authenticated family favourites snapshot and replaces the
        local favourites cache, keeping a device's quick-play menu consistent
        with the parent app.

config FAVORITES_SYNC_INTERVAL_SECONDS
    int "Favourites sync interval in seconds"
    depends on FEATURE_FAVORITES_SYNC
    range 60 86400
    default 900

config FAVORITES_SYNC_RETRY_INTERVAL_SECONDS
    int "Favourites sync retry interval while offline"
    depends on FEATURE_FAVORITES_SYNC
    range 5 300
    default 15

endmenu
```

## components/form_factor_profile/Kconfig
```kconfig
menu "Sprout feature modules"

config FEATURE_FORM_FACTOR_PROFILE
    bool "Enable capability-composed form-factor profile"
    default n
    help
        Composes the advertised action set from a body's capability set so the
        same voice, content and platform modules run on a desktop, a moving
        body or a wearable. Swapping a body only swaps the profile and its
        assets; the profile never binds to a character or an appearance.

endmenu
```

## components/form_factor_report/Kconfig
```kconfig
menu "Sprout feature modules"

config FEATURE_FORM_FACTOR_REPORT
    bool "Report the composed form-factor profile to the platform"
    default n
    depends on FEATURE_FORM_FACTOR_PROFILE && FEATURE_DEVICE_BINDING_CLIENT && FEATURE_NETWORK_MANAGER && FEATURE_TIME_SYNC
    help
        Reports the device's composed form-factor profile (technical name and
        capability mask) so the guardian view matches the hardware actually
        present. The platform derives the action set from the capability mask.

config FORM_FACTOR_REPORT_INTERVAL_SECONDS
    int "Form-factor report interval in seconds"
    depends on FEATURE_FORM_FACTOR_REPORT
    range 300 86400
    default 3600

config FORM_FACTOR_REPORT_RETRY_INTERVAL_SECONDS
    int "Form-factor report retry interval while offline"
    depends on FEATURE_FORM_FACTOR_REPORT
    range 5 300
    default 15

endmenu
```

## components/growth_record/Kconfig
```kconfig
menu "Sprout feature modules"

config FEATURE_GROWTH_RECORD
    bool "Enable growth record cache"
    default y
    help
        Caches a bounded list of the guardian's growth records (milestones,
        encouragement, habits and emotions) persisted across restarts so the
        device can celebrate progress offline and echo it in the parent app's
        companionship timeline.

endmenu
```
