## components/content_package_manager/Kconfig
```kconfig
menu "Sprout feature modules"

config FEATURE_CONTENT_PACKAGE_MANAGER
    bool "Enable content package synchronisation"
    default n
    depends on FEATURE_CONTENT_LIBRARY && FEATURE_CONTENT_DOWNLOADER && FEATURE_DEVICE_BINDING_CLIENT && FEATURE_NETWORK_MANAGER && FEATURE_TIME_SYNC
    help
        Fetches the authenticated device content manifest, merges changes into
        the local index, queues missing packages, deletes withdrawn packages,
        and exposes pause, resume, and progress for the device UI.

config CONTENT_PACKAGE_SYNC_INTERVAL_SECONDS
    int "Manifest sync interval in seconds"
    depends on FEATURE_CONTENT_PACKAGE_MANAGER
    range 60 86400
    default 900

endmenu
```

## components/conversation_context/Kconfig
```kconfig
menu "Sprout feature modules"

config FEATURE_CONVERSATION_CONTEXT
    bool "Enable bounded on-device conversation context"
    default n
    help
        Retain the last few turn summaries for the active conversation so the
        device can label a session and build a bounded offline fallback prompt.
        The gateway remains the owner of the authoritative multi-turn history.

endmenu
```

## components/device_binding_client/Kconfig
```kconfig
menu "Sprout feature modules"

config FEATURE_DEVICE_BINDING_CLIENT
    bool "Enable device binding client"
    default y
    depends on FEATURE_CONFIG_STORE && FEATURE_DEVICE_IDENTITY
    help
        Contacts device_platform to register this device, prove its identity
        with an ECDSA challenge, request a single-use binding token, and detect
        when a guardian completes binding.

config DEVICE_BINDING_PLATFORM_BASE_URL
    string "Device platform HTTPS base URL"
    depends on FEATURE_DEVICE_BINDING_CLIENT
    default ""
    help
        Base URL of device_platform. Must use HTTPS so certificate validation
        stays enabled.

config DEVICE_BINDING_HARDWARE_MODEL
    string "Hardware model reported during registration"
    depends on FEATURE_DEVICE_BINDING_CLIENT
    default "sprout-s3-n16r8"
    help
        Capability-oriented hardware model name sent to device_platform. It
        must not contain a character, product-shape, or SKU codename.

endmenu
```

## components/device_capabilities/Kconfig
```kconfig
menu "Sprout feature modules"

config FEATURE_DEVICE_CAPABILITIES
    bool "Enable device capability reporting"
    default y
    help
        Expose the capability set compiled into this firmware image. The
        capability names are shared with the platform device contract.

config CAPABILITY_AUDIO_INPUT
    bool "Advertise audio input"
    depends on FEATURE_DEVICE_CAPABILITIES
    default y

config CAPABILITY_AUDIO_OUTPUT
    bool "Advertise audio output"
    depends on FEATURE_DEVICE_CAPABILITIES
    default y

config CAPABILITY_WIFI
    bool "Advertise Wi-Fi"
    depends on FEATURE_DEVICE_CAPABILITIES
    default y

config CAPABILITY_CAMERA
    bool "Advertise camera"
    depends on FEATURE_DEVICE_CAPABILITIES
    default n

config CAPABILITY_DISPLAY
    bool "Advertise display"
    depends on FEATURE_DEVICE_CAPABILITIES
    default n

config CAPABILITY_TOUCH
    bool "Advertise touch input"
    depends on FEATURE_DEVICE_CAPABILITIES
    default n

config CAPABILITY_LED
    bool "Advertise LED"
    depends on FEATURE_DEVICE_CAPABILITIES
    default n

config CAPABILITY_BATTERY
    bool "Advertise battery"
    depends on FEATURE_DEVICE_CAPABILITIES
    default n

config CAPABILITY_CELLULAR_4G
    bool "Advertise cellular 4G"
    depends on FEATURE_DEVICE_CAPABILITIES
    default n

config CAPABILITY_MOTION
    bool "Advertise motion"
    depends on FEATURE_DEVICE_CAPABILITIES
    default n

config CAPABILITY_BLUETOOTH_AUDIO
    bool "Advertise Bluetooth audio"
    depends on FEATURE_DEVICE_CAPABILITIES
    default n

config CAPABILITY_VIDEO_CALL
    bool "Advertise video call"
    depends on FEATURE_DEVICE_CAPABILITIES
    default n

config CAPABILITY_LOCATION
    bool "Advertise location"
    depends on FEATURE_DEVICE_CAPABILITIES
    default n

config CAPABILITY_GEOFENCE
    bool "Advertise geofence"
    depends on FEATURE_DEVICE_CAPABILITIES
    default n

config CAPABILITY_SOS
    bool "Advertise SOS"
    depends on FEATURE_DEVICE_CAPABILITIES
    default n

config CAPABILITY_MULTI_DEVICE
    bool "Advertise multi-device support"
    depends on FEATURE_DEVICE_CAPABILITIES
    default n

endmenu
```

## components/device_identity/Kconfig
```kconfig
menu "Sprout feature modules"

config FEATURE_DEVICE_IDENTITY
    bool "Enable device identity"
    default y
    help
        Derive a stable device identifier from the factory MAC without
        exposing the raw MAC in device payloads. Generates and stores the
        device's ECDSA P-256 key pair in NVS for platform authentication.

config DEVICE_IDENTITY_NVS_PARTITION
    string "NVS partition name for device identity"
    depends on FEATURE_DEVICE_IDENTITY
    default "nvs"
    help
        NVS partition that stores the device key pair. Production images must
        enable NVS encryption for this partition.

endmenu
```

## components/device_message/Kconfig
```kconfig
menu "Sprout feature modules"

config FEATURE_DEVICE_MESSAGE
    bool "Enable guardian device message presenter"
    default y
    help
        Accepts the display_message runtime command and presents guardian
        authored copy. Display builds render it on the device screen; builds
        without the DISPLAY capability record the message and confirm the
        command with a bounded LED cue instead of retrying forever.

endmenu
```

## components/device_mqtt/Kconfig
```kconfig
menu "Sprout feature modules"

config FEATURE_DEVICE_MQTT
    bool "Enable the device MQTT command contract"
    default y
    help
        Parses platform-to-device command envelopes from the shared MQTT
        contract, validates the topic-derived device identity, suppresses QoS 1
        duplicate deliveries, and builds idempotent command acknowledgements.
        The transport connection is owned by the composition root once the
        production broker endpoint and client certificate are confirmed.

endmenu
```

## components/device_provisioning/Kconfig
```kconfig
menu "Sprout feature modules"

config FEATURE_DEVICE_PROVISIONING
    bool "Enable device provisioning"
    default y
    depends on FEATURE_CONFIG_STORE && FEATURE_DEVICE_BINDING_CLIENT && FEATURE_NETWORK_MANAGER && FEATURE_PROVISIONING_PAYLOAD
    help
        Owns the BLE provisioning service, receives Wi-Fi credentials, returns
        the one-time binding URI to the guardian application, and persists the
        completed binding state.

config DEVICE_PROVISIONING_SERVICE_PREFIX
    string "Provisioning service name prefix"
    depends on FEATURE_DEVICE_PROVISIONING
    default "SPROUT"
    help
        Prefix used for the BLE device name. The last three bytes of the Wi-Fi
        station MAC are appended to make nearby devices distinguishable.

endmenu
```

## components/device_runtime_reporter/Kconfig
```kconfig
menu "Sprout feature modules"

config FEATURE_DEVICE_RUNTIME_REPORTER
    bool "Enable cloud runtime reporting"
    default y
    depends on FEATURE_CONFIG_STORE && FEATURE_DEVICE_BINDING_CLIENT && FEATURE_CLOUD_AUTH && FEATURE_NETWORK_MANAGER && FEATURE_NETWORK_QUALITY && FEATURE_OFFLINE_FALLBACK && FEATURE_TIME_SYNC
    help
        Sends authenticated heartbeat snapshots to device_platform, refreshes
        the device session when needed, applies server-supplied time, and
        executes network maintenance commands.

config DEVICE_RUNTIME_HEARTBEAT_INTERVAL_SECONDS
    int "Heartbeat interval in seconds"
    depends on FEATURE_DEVICE_RUNTIME_REPORTER
    range 15 3600
    default 30

endmenu
```

## components/diagnostic_reporter/Kconfig
```kconfig
menu "Sprout feature modules"

config FEATURE_DIAGNOSTIC_REPORTER
    bool "Enable boot and module failure diagnostics"
    default y
    depends on FEATURE_CONFIG_STORE && FEATURE_ERROR_RECOVERY && FEATURE_VERSION_INFO
    help
        Records bounded boot events and the latest removable-module failure
        in non-volatile storage. The runtime reporter includes pending
        diagnostics in its authenticated heartbeat and acknowledges them only
        after the platform accepts the report.

endmenu
```

## components/display_policy/Kconfig
```kconfig
menu "Sprout feature modules"

config FEATURE_DISPLAY_POLICY
    bool "Enable eye-care display policy"
    default n
    help
        Applies the guardian's brightness, colour temperature, viewing
        distance, daily screen-time and break-reminder policy on the device.
        The module only touches display and timing state, so a device without a
        screen never links it.

endmenu
```

## components/display_policy_sync/Kconfig
```kconfig
menu "Sprout feature modules"

config FEATURE_DISPLAY_POLICY_SYNC
    bool "Enable eye-care display policy synchronisation"
    default y
    depends on FEATURE_DISPLAY_POLICY && FEATURE_DEVICE_BINDING_CLIENT && FEATURE_NETWORK_MANAGER && FEATURE_TIME_SYNC
    help
        Fetches the family eye-care policy and applies it, keeping a device's
        brightness, colour temperature, viewing-distance reminder, daily
        screen-time cap and break reminder consistent with the parent app.

config DISPLAY_POLICY_SYNC_INTERVAL_SECONDS
    int "Display policy sync interval in seconds"
    depends on FEATURE_DISPLAY_POLICY_SYNC
    range 60 86400
    default 1800

config DISPLAY_POLICY_SYNC_RETRY_INTERVAL_SECONDS
    int "Display policy sync retry interval while offline"
    depends on FEATURE_DISPLAY_POLICY_SYNC
    range 5 300
    default 15

endmenu
```

## components/display_report/Kconfig
```kconfig
menu "Sprout feature modules"

config FEATURE_DISPLAY_REPORT
    bool "Report the live display status to the platform"
    default n
    depends on FEATURE_DISPLAY_POLICY && FEATURE_DEVICE_BINDING_CLIENT && FEATURE_NETWORK_MANAGER && FEATURE_TIME_SYNC
    help
        Reports the device's brightness, panel size and touch support so the
        guardian display view matches the panel actually present. A device
        without a display never links the component.

config DISPLAY_REPORT_PANEL_WIDTH
    int "Panel width in pixels, or 0 when the device does not declare one"
    depends on FEATURE_DISPLAY_REPORT
    range 0 8192
    default 0

config DISPLAY_REPORT_PANEL_HEIGHT
    int "Panel height in pixels, or 0 when the device does not declare one"
    depends on FEATURE_DISPLAY_REPORT
    range 0 8192
    default 0

config DISPLAY_REPORT_INTERVAL_SECONDS
    int "Display report interval in seconds"
    depends on FEATURE_DISPLAY_REPORT
    range 300 86400
    default 900

config DISPLAY_REPORT_RETRY_INTERVAL_SECONDS
    int "Display report retry interval while offline"
    depends on FEATURE_DISPLAY_REPORT
    range 5 300
    default 15

endmenu
```

## components/emotion_report/Kconfig
```kconfig
menu "Sprout feature modules"

# Secure by default: supervising a child's mood is a guardian decision, so the
# device never reports a sample until the feature is compiled in AND the family
# has turned mood sensing on in the parent app. The platform refuses samples
# with 403 while the family switch is off.
config FEATURE_EMOTION_REPORT
    bool "Report emotion observations to the platform"
    default n
    depends on FEATURE_COMPANIONSHIP && FEATURE_DEVICE_BINDING_CLIENT && FEATURE_NETWORK_MANAGER && FEATURE_TIME_SYNC
    help
        Sends one coarse mood sample (label, confidence, observation instant)
        to POST /api/v1/devices/{device_id}/emotion-observations each time the
        companionship module settles on an emotion after a wake or a finished
        turn. No conversation text, audio, or image ever leaves the device.
        Companionship keeps working locally when this is disabled.

config EMOTION_REPORT_INTERVAL_SECONDS
    int "Minimum interval between two reported samples in seconds"
    depends on FEATURE_EMOTION_REPORT
    range 30 3600
    default 60
    help
        A child who is awake and chatting produces many turns per minute; a
        sample per turn would turn an aggregate into a minute-by-minute log of
        one child. One sample per minute still gives a weekly distribution.

config EMOTION_REPORT_RETRY_INTERVAL_SECONDS
    int "Retry interval after a transient upload failure in seconds"
    depends on FEATURE_EMOTION_REPORT
    range 5 600
    default 30

config EMOTION_REPORT_BACKOFF_MAX_SECONDS
    int "Maximum retry backoff after consecutive failures in seconds"
    depends on FEATURE_EMOTION_REPORT
    range 60 3600
    default 900
    help
        Each consecutive failure doubles the wait between attempts up to this
        ceiling, so a platform outage or an unregistered device stops asking
        instead of retrying on every turn.

config EMOTION_REPORT_QUEUE_CAPACITY
    int "Samples held locally while offline"
    depends on FEATURE_EMOTION_REPORT
    range 0 32
    default 8
    help
        Samples recorded while the device cannot reach the platform wait for
        the next worker cycle. The oldest sample is dropped when the queue is
        full, because a mood distribution is worth more than one old instant
        and every retained sample is retained child data.

endmenu
```

## components/english_course/Kconfig
```kconfig
menu "Sprout feature modules"

config FEATURE_ENGLISH_COURSE
    bool "Enable English course cache and practice log"
    default y
    help
        Caches a bounded English lesson catalog (words and sentence patterns)
        and a bounded local practice-attempt log with pronunciation scores. The
        device can keep the lessons and the child's practice offline and echo
        the scores in the parent app's English learning view.

endmenu
```

## components/english_course_sync/Kconfig
```kconfig
menu "Sprout feature modules"

config FEATURE_ENGLISH_COURSE_SYNC
    bool "Enable English lesson catalog synchronisation"
    default y
    depends on FEATURE_ENGLISH_COURSE && FEATURE_DEVICE_BINDING_CLIENT && FEATURE_NETWORK_MANAGER && FEATURE_TIME_SYNC
    help
        Fetches the published English lesson catalog (words and sentence
        patterns) and replaces the local lesson cache so the child can practise
        offline with the same content the parent app shows.

config ENGLISH_COURSE_SYNC_INTERVAL_SECONDS
    int "English lesson sync interval in seconds"
    depends on FEATURE_ENGLISH_COURSE_SYNC
    range 300 86400
    default 3600

config ENGLISH_COURSE_SYNC_RETRY_INTERVAL_SECONDS
    int "English lesson sync retry interval while offline"
    depends on FEATURE_ENGLISH_COURSE_SYNC
    range 5 300
    default 15

endmenu
```

## components/error_code/Kconfig
```kconfig
menu "Sprout feature modules"

config FEATURE_ERROR_CODE
    bool "Enable shared error codes"
    default y
    help
        Map firmware failures to stable error strings shared with platform
        services. ESP-IDF error numbers must not cross the device contract.

endmenu
```

## components/error_recovery/Kconfig
```kconfig
menu "Sprout feature modules"

config FEATURE_ERROR_RECOVERY
    bool "Enable error recovery"
    default y
    help
        Record recoverable module failures and provide a controlled restart
        path for unrecoverable states.

config ERROR_RECOVERY_RESTART_DELAY_MS
    int "Restart delay after an unrecoverable error"
    depends on FEATURE_ERROR_RECOVERY
    range 100 60000
    default 2000

endmenu
```
